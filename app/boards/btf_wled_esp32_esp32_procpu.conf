## app/boards/btf_wled_esp32_esp32_procpu.conf
```kconfig
# SPDX-License-Identifier: Apache-2.0
#
# btf_wled_esp32/esp32/procpu (classic ESP32-WROOM-32E): the RAM diet.
# Merged automatically after prj.conf for this board target only; the
# EXTRA_CONF_FILE variants (rgb/prov) still override where they need to.
#
# Usable DRAM on this SoC is two banks: dram0 ≈ 136K (SRAM2 minus the 56K
# BT-blob reserve) for .bss+.data, and dram1 = 96K which on this port only
# receives .noinit. The build sits at ~99.7% of dram0 — every static
# allocation matters. None of this applies to the ESP32-C6 board, whose
# 512K HP-SRAM is a single unified bank.

# The CHIP heap (chip-patches/0002) and thread stacks live in the second
# DRAM bank via .noinit. This is the default today, but Zephyr 4.4 turns
# it off under MCUboot — pin it so an OTA experiment can't silently
# implode the RAM budget.
CONFIG_ESP32_REGION_1_NOINIT=y

# The sys_heap buffer is relocated to the second DRAM bank
# (chip-patches/0002); 40K is what fits there next to the stacks.
CONFIG_CHIP_MALLOC_SYS_HEAP_SIZE=40960

# Open-key-slot table lives in dram0 .bss (~40 B/slot inside tf-psa-crypto's
# global_data): 64 slots (the NXP default) overflowed dram0 by 808 bytes.
# Slots only bound concurrently-open keys (sessions + handshake ephemerals),
# not stored keys; 32 is ample for 4 fabrics.
CONFIG_MBEDTLS_PSA_KEY_SLOT_COUNT=32

# WiFi driver buffers come out of the kernel pool at runtime; trim to match
# the lowered pool floor (measured in the M1 spike; see also the
# HEAP_MEM_POOL_ADD_SIZE_ESP_* re-defaults in app/Kconfig).
CONFIG_ESP32_WIFI_STATIC_RX_BUFFER_NUM=6
CONFIG_ESP32_WIFI_DYNAMIC_RX_BUFFER_NUM=16
CONFIG_ESP32_WIFI_DYNAMIC_TX_BUFFER_NUM=16
CONFIG_ESP32_WIFI_AMPDU_TX_ENABLED=n
CONFIG_ESP32_WIFI_AMPDU_RX_ENABLED=n

# The LX6 has a hardware FPU; enable lazy FP context save for the float
# color math. (The C6's rv32imac core has none -- soft-float there.)
CONFIG_FPU=y
```

## boards/btf/btf_wled_esp32/Kconfig
```kconfig
# SPDX-License-Identifier: Apache-2.0

# The ESP32 interrupt controller and flash drivers k_malloc() at runtime;
# without a board heap contribution the kernel heap is size 0 and the
# image does not link.
config HEAP_MEM_POOL_ADD_SIZE_BOARD
	int
	default 4096 if BOARD_BTF_WLED_ESP32_ESP32_PROCPU
```

## boards/btf/btf_wled_esp32/Kconfig.btf_wled_esp32
```kconfig
# SPDX-License-Identifier: Apache-2.0

config BOARD_BTF_WLED_ESP32
	select SOC_ESP32_WROOM_32UE_N4
	select SOC_ESP32_PROCPU if BOARD_BTF_WLED_ESP32_ESP32_PROCPU
	select SOC_ESP32_APPCPU if BOARD_BTF_WLED_ESP32_ESP32_APPCPU
```

## boards/btf/btf_wled_esp32/board.yml
```yaml
board:
  name: btf_wled_esp32
  full_name: BTF-Lighting ESP32 WLED Controller
  vendor: btf
  socs:
  - name: esp32
```

## boards/btf/btf_wled_esp32c6/Kconfig
```kconfig
# SPDX-License-Identifier: Apache-2.0

# The Espressif interrupt controller and flash drivers k_malloc() at
# runtime; without a board heap contribution the kernel heap is size 0
# and the image does not link. 4096 matches esp32c6_devkitc.
config HEAP_MEM_POOL_ADD_SIZE_BOARD
	int
	default 4096 if BOARD_BTF_WLED_ESP32C6_ESP32C6_HPCORE
```

## boards/btf/btf_wled_esp32c6/Kconfig.btf_wled_esp32c6
```kconfig
# SPDX-License-Identifier: Apache-2.0

# Zephyr 4.4 only defines the 1U (external antenna) module variants; the
# PCB-antenna ESP32-C6-WROOM-1-N8 on the reworked board is electrically
# identical (same die, same 8MB flash), so select the 1U-N8 symbol.
config BOARD_BTF_WLED_ESP32C6
	select SOC_ESP32_C6_WROOM_1U_N8
	select SOC_ESP32C6_HPCORE if BOARD_BTF_WLED_ESP32C6_ESP32C6_HPCORE
```

## boards/btf/btf_wled_esp32c6/board.yml
```yaml
board:
  name: btf_wled_esp32c6
  full_name: BTF-Lighting WLED Controller (ESP32-C6 rework)
  vendor: btf
  socs:
  - name: esp32c6
```

## manifest/west.yml
```yaml
manifest:
  remotes:
    - name: zephyrproject-rtos
      url-base: https://github.com/zephyrproject-rtos

  projects:
    - name: zephyr
      remote: zephyrproject-rtos
      # v4.4 splits crypto into mbedtls 4.x + tf-psa-crypto and removes the
      # legacy MBEDTLS_*_C Kconfig surface; CHIP runs on its PSA backend
      # (CONFIG_CHIP_CRYPTO_PSA). See docs/zephyr-4.4-upgrade-notes.md.
      revision: v4.4.1
      import:
        # Only pull the modules we actually build against.
        name-allowlist:
          - hal_espressif   # ESP32 HAL, WiFi/BT blobs, esptool west runner
          - mbedtls         # mbedTLS 4.x front end (X.509/PK for CHIP)
          - tf-psa-crypto   # PSA crypto core (mbedTLS 4.x split)
          - picolibc        # libc
          - openthread      # never compiled (CONFIG_NET_L2_OPENTHREAD=n), but
                            # CHIP's chip-module declares a hard module
                            # dependency on it
          - mcuboot         # unused by the MVP (simple boot); staged for OTA

    - name: connectedhomeip
      url: https://github.com/project-chip/connectedhomeip
      path: modules/connectedhomeip
      # Master pin, not a release: v1.5.x's platform/Zephyr still uses BLE
      # advertising flags that were removed in Zephyr 4.x. Master head as of
      # 2026-07-01; contains #72415 (WifiManager assert fix, retired our
      # 0001 patch), #72416 (mbedTLS-4 ecp.h include guard, mandatory for
      # Zephyr 4.4's TF-PSA-Crypto), #72701/#72698 (deprecated Zephyr API
      # removal + OTA rework in the zephyr platform/scaffold).
      revision: 9d45993e3fc0655c51591892a850aef89b10289a
      # CHIP's submodules are managed by its own scripts/checkout_submodules.py
      # (see bootstrap.sh), not by west.
      submodules: false
```

## tests/color_math/testcase.yaml
```yaml
tests:
  app.color_math:
    platform_allow:
      - native_sim/native/64
    tags:
      - color_math
```

## twister-out.1/native_sim_native/host/tests/color_math/app.color_math/Kconfig/Kconfig.shield.defconfig
```kconfig
osource "/home/mspatz/code/esp32_matter_led_controller/manifest/../boards/shields/*/Kconfig.defconfig"
```

## twister-out.1/native_sim_native/host/tests/color_math/app.color_math/Kconfig/arch/Kconfig
```kconfig
# Load Zephyr Arch Kconfig descriptions.
osource "/home/mspatz/code/esp32_matter_led_controller/zephyr/arch/rx/Kconfig"
osource "/home/mspatz/code/esp32_matter_led_controller/zephyr/arch/x86/Kconfig"
osource "/home/mspatz/code/esp32_matter_led_controller/zephyr/arch/xtensa/Kconfig"
osource "/home/mspatz/code/esp32_matter_led_controller/zephyr/arch/sparc/Kconfig"
osource "/home/mspatz/code/esp32_matter_led_controller/zephyr/arch/riscv/Kconfig"
osource "/home/mspatz/code/esp32_matter_led_controller/zephyr/arch/posix/Kconfig"
osource "/home/mspatz/code/esp32_matter_led_controller/zephyr/arch/mips/Kconfig"
osource "/home/mspatz/code/esp32_matter_led_controller/zephyr/arch/arm64/Kconfig"
osource "/home/mspatz/code/esp32_matter_led_controller/zephyr/arch/arm/Kconfig"
osource "/home/mspatz/code/esp32_matter_led_controller/zephyr/arch/arc/Kconfig"
```

## twister-out.1/native_sim_native/host/tests/color_math/app.color_math/Kconfig/boards/Kconfig.sysbuild
```kconfig
# Load Sysbuild board Kconfig descriptions.
osource "/home/mspatz/code/esp32_matter_led_controller/zephyr/boards/native/native_sim/Kconfig.sysbuild"
```
