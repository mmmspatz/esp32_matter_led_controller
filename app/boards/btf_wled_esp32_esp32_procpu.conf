## twister-out.1/native_sim_native/host/tests/color_math/app.color_math/Kconfig/soc/Kconfig.defconfig
```kconfig
# Load Zephyr SoC defconfig descriptions.
osource "/home/mspatz/code/esp32_matter_led_controller/zephyr/soc/xlnx/zynqmp/Kconfig.defconfig"
osource "/home/mspatz/code/esp32_matter_led_controller/zephyr/soc/xlnx/zynq7000/Kconfig.defconfig"
osource "/home/mspatz/code/esp32_matter_led_controller/zephyr/soc/xlnx/versalnet/Kconfig.defconfig"
osource "/home/mspatz/code/esp32_matter_led_controller/zephyr/soc/xlnx/versal2/Kconfig.defconfig"
osource "/home/mspatz/code/esp32_matter_led_controller/zephyr/soc/xen/Kconfig.defconfig"
osource "/home/mspatz/code/esp32_matter_led_controller/zephyr/soc/wch/ch32v/Kconfig.defconfig"
osource "/home/mspatz/code/esp32_matter_led_controller/zephyr/soc/ti/simplelink/Kconfig.defconfig"
osource "/home/mspatz/code/esp32_matter_led_controller/zephyr/soc/ti/mspm0/Kconfig.defconfig"
osource "/home/mspatz/code/esp32_matter_led_controller/zephyr/soc/ti/lm3s6965/Kconfig.defconfig"
osource "/home/mspatz/code/esp32_matter_led_controller/zephyr/soc/ti/k3/Kconfig.defconfig"
osource "/home/mspatz/code/esp32_matter_led_controller/zephyr/soc/telink/tlsr/Kconfig.defconfig"
osource "/home/mspatz/code/esp32_matter_led_controller/zephyr/soc/starfive/jh71xx/Kconfig.defconfig"
osource "/home/mspatz/code/esp32_matter_led_controller/zephyr/soc/st/stm32/Kconfig.defconfig"
osource "/home/mspatz/code/esp32_matter_led_controller/zephyr/soc/snps/qemu_arc/Kconfig.defconfig"
osource "/home/mspatz/code/esp32_matter_led_controller/zephyr/soc/snps/nsim/arc_v/Kconfig.defconfig"
osource "/home/mspatz/code/esp32_matter_led_controller/zephyr/soc/snps/nsim/arc_classic/Kconfig.defconfig"
osource "/home/mspatz/code/esp32_matter_led_controller/zephyr/soc/snps/hsdk4xd/Kconfig.defconfig"
osource "/home/mspatz/code/esp32_matter_led_controller/zephyr/soc/snps/hsdk/Kconfig.defconfig"
osource "/home/mspatz/code/esp32_matter_led_controller/zephyr/soc/snps/emsk/Kconfig.defconfig"
osource "/home/mspatz/code/esp32_matter_led_controller/zephyr/soc/snps/emsdp/Kconfig.defconfig"
osource "/home/mspatz/code/esp32_matter_led_controller/zephyr/soc/snps/arc_iot/Kconfig.defconfig"
osource "/home/mspatz/code/esp32_matter_led_controller/zephyr/soc/silabs/Kconfig.defconfig"
osource "/home/mspatz/code/esp32_matter_led_controller/zephyr/soc/sifli/sf32/Kconfig.defconfig"
osource "/home/mspatz/code/esp32_matter_led_controller/zephyr/soc/sifive/sifive_freedom/Kconfig.defconfig"
osource "/home/mspatz/code/esp32_matter_led_controller/zephyr/soc/sensry/Kconfig.defconfig"
osource "/home/mspatz/code/esp32_matter_led_controller/zephyr/soc/rockchip/Kconfig.defconfig"
osource "/home/mspatz/code/esp32_matter_led_controller/zephyr/soc/renode/riscv_virtual/Kconfig.defconfig"
osource "/home/mspatz/code/esp32_matter_led_controller/zephyr/soc/renode/cortex_r8_virtual/Kconfig.defconfig"
osource "/home/mspatz/code/esp32_matter_led_controller/zephyr/soc/renesas/smartbond/Kconfig.defconfig"
osource "/home/mspatz/code/esp32_matter_led_controller/zephyr/soc/renesas/rz/Kconfig.defconfig"
osource "/home/mspatz/code/esp32_matter_led_controller/zephyr/soc/renesas/rx/Kconfig.defconfig"
osource "/home/mspatz/code/esp32_matter_led_controller/zephyr/soc/renesas/rcar/Kconfig.defconfig"
osource "/home/mspatz/code/esp32_matter_led_controller/zephyr/soc/renesas/ra/Kconfig.defconfig"
osource "/home/mspatz/code/esp32_matter_led_controller/zephyr/soc/realtek/ec/Kconfig.defconfig"
osource "/home/mspatz/code/esp32_matter_led_controller/zephyr/soc/raspberrypi/rpi_pico/Kconfig.defconfig"
osource "/home/mspatz/code/esp32_matter_led_controller/zephyr/soc/quicklogic/eos_s3/Kconfig.defconfig"
osource "/home/mspatz/code/esp32_matter_led_controller/zephyr/soc/qemu/virt_riscv/Kconfig.defconfig"
osource "/home/mspatz/code/esp32_matter_led_controller/zephyr/soc/qemu/malta/Kconfig.defconfig"
osource "/home/mspatz/code/esp32_matter_led_controller/zephyr/soc/openisa/rv32m1/Kconfig.defconfig"
osource "/home/mspatz/code/esp32_matter_led_controller/zephyr/soc/openhwgroup/cva6/Kconfig.defconfig"
osource "/home/mspatz/code/esp32_matter_led_controller/zephyr/soc/oct/osd32mp15x/Kconfig.defconfig"
osource "/home/mspatz/code/esp32_matter_led_controller/zephyr/soc/nxp/s32/Kconfig.defconfig"
osource "/home/mspatz/code/esp32_matter_led_controller/zephyr/soc/nxp/rw/Kconfig.defconfig"
osource "/home/mspatz/code/esp32_matter_led_controller/zephyr/soc/nxp/mcx/Kconfig.defconfig"
osource "/home/mspatz/code/esp32_matter_led_controller/zephyr/soc/nxp/lpc/Kconfig.defconfig"
osource "/home/mspatz/code/esp32_matter_led_controller/zephyr/soc/nxp/layerscape/Kconfig.defconfig"
osource "/home/mspatz/code/esp32_matter_led_controller/zephyr/soc/nxp/kinetis/Kconfig.defconfig"
osource "/home/mspatz/code/esp32_matter_led_controller/zephyr/soc/nxp/imxrt/Kconfig.defconfig"
osource "/home/mspatz/code/esp32_matter_led_controller/zephyr/soc/nxp/imx/Kconfig.defconfig"
osource "/home/mspatz/code/esp32_matter_led_controller/zephyr/soc/nuvoton/numicro/Kconfig.defconfig"
osource "/home/mspatz/code/esp32_matter_led_controller/zephyr/soc/nuvoton/numaker/Kconfig.defconfig"
osource "/home/mspatz/code/esp32_matter_led_controller/zephyr/soc/nuvoton/npcx/Kconfig.defconfig"
osource "/home/mspatz/code/esp32_matter_led_controller/zephyr/soc/nuvoton/npcm/Kconfig.defconfig"
osource "/home/mspatz/code/esp32_matter_led_controller/zephyr/soc/nordic/Kconfig.defconfig"
osource "/home/mspatz/code/esp32_matter_led_controller/zephyr/soc/neorv32/Kconfig.defconfig"
osource "/home/mspatz/code/esp32_matter_led_controller/zephyr/soc/native/inf_clock/Kconfig.defconfig"
osource "/home/mspatz/code/esp32_matter_led_controller/zephyr/soc/microchip/sam/Kconfig.defconfig"
osource "/home/mspatz/code/esp32_matter_led_controller/zephyr/soc/microchip/sam/sama7/Kconfig.defconfig"
osource "/home/mspatz/code/esp32_matter_led_controller/zephyr/soc/microchip/sam/sam_d5x_e5x/Kconfig.defconfig"
osource "/home/mspatz/code/esp32_matter_led_controller/zephyr/soc/microchip/pic32c/pic32cz_ca/Kconfig.defconfig"
osource "/home/mspatz/code/esp32_matter_led_controller/zephyr/soc/microchip/pic32c/pic32cx_sg/Kconfig.defconfig"
osource "/home/mspatz/code/esp32_matter_led_controller/zephyr/soc/microchip/pic32c/pic32cm_jh/Kconfig.defconfig"
osource "/home/mspatz/code/esp32_matter_led_controller/zephyr/soc/microchip/miv/Kconfig.defconfig"
osource "/home/mspatz/code/esp32_matter_led_controller/zephyr/soc/microchip/mec/Kconfig.defconfig"
osource "/home/mspatz/code/esp32_matter_led_controller/zephyr/soc/mediatek/mt8xxx/Kconfig.defconfig"
osource "/home/mspatz/code/esp32_matter_led_controller/zephyr/soc/lowrisc/opentitan/Kconfig.defconfig"
osource "/home/mspatz/code/esp32_matter_led_controller/zephyr/soc/litex/litex_vexriscv/Kconfig.defconfig"
osource "/home/mspatz/code/esp32_matter_led_controller/zephyr/soc/ite/ec/Kconfig.defconfig"
osource "/home/mspatz/code/esp32_matter_led_controller/zephyr/soc/intel/raptor_lake/Kconfig.defconfig"
osource "/home/mspatz/code/esp32_matter_led_controller/zephyr/soc/intel/panther_lake/Kconfig.defconfig"
osource "/home/mspatz/code/esp32_matter_led_controller/zephyr/soc/intel/lakemont/Kconfig.defconfig"
osource "/home/mspatz/code/esp32_matter_led_controller/zephyr/soc/intel/intel_socfpga_std/Kconfig.defconfig"
osource "/home/mspatz/code/esp32_matter_led_controller/zephyr/soc/intel/intel_socfpga/Kconfig.defconfig"
osource "/home/mspatz/code/esp32_matter_led_controller/zephyr/soc/intel/intel_niosv/Kconfig.defconfig"
osource "/home/mspatz/code/esp32_matter_led_controller/zephyr/soc/intel/intel_ish/Kconfig.defconfig"
osource "/home/mspatz/code/esp32_matter_led_controller/zephyr/soc/intel/intel_adsp/Kconfig.defconfig"
osource "/home/mspatz/code/esp32_matter_led_controller/zephyr/soc/intel/elkhart_lake/Kconfig.defconfig"
osource "/home/mspatz/code/esp32_matter_led_controller/zephyr/soc/intel/atom/Kconfig.defconfig"
osource "/home/mspatz/code/esp32_matter_led_controller/zephyr/soc/intel/apollo_lake/Kconfig.defconfig"
osource "/home/mspatz/code/esp32_matter_led_controller/zephyr/soc/intel/alder_lake/Kconfig.defconfig"
osource "/home/mspatz/code/esp32_matter_led_controller/zephyr/soc/infineon/edge/Kconfig.defconfig"
osource "/home/mspatz/code/esp32_matter_led_controller/zephyr/soc/infineon/cat3/Kconfig.defconfig"
osource "/home/mspatz/code/esp32_matter_led_controller/zephyr/soc/infineon/cat1c/Kconfig.defconfig"
osource "/home/mspatz/code/esp32_matter_led_controller/zephyr/soc/infineon/cat1b/Kconfig.defconfig"
osource "/home/mspatz/code/esp32_matter_led_controller/zephyr/soc/infineon/cat1a/Kconfig.defconfig"
osource "/home/mspatz/code/esp32_matter_led_controller/zephyr/soc/gd/gd32/Kconfig.defconfig"
osource "/home/mspatz/code/esp32_matter_led_controller/zephyr/soc/gaisler/leon3/Kconfig.defconfig"
osource "/home/mspatz/code/esp32_matter_led_controller/zephyr/soc/gaisler/gr716a/Kconfig.defconfig"
osource "/home/mspatz/code/esp32_matter_led_controller/zephyr/soc/espressif/Kconfig.defconfig"
osource "/home/mspatz/code/esp32_matter_led_controller/zephyr/soc/ene/kb1200/Kconfig.defconfig"
osource "/home/mspatz/code/esp32_matter_led_controller/zephyr/soc/ene/kb106x/Kconfig.defconfig"
osource "/home/mspatz/code/esp32_matter_led_controller/zephyr/soc/egis/Kconfig.defconfig"
osource "/home/mspatz/code/esp32_matter_led_controller/zephyr/soc/efinix/sapphire/Kconfig.defconfig"
osource "/home/mspatz/code/esp32_matter_led_controller/zephyr/soc/cdns/xtensa_sample_controller/Kconfig.defconfig"
osource "/home/mspatz/code/esp32_matter_led_controller/zephyr/soc/cdns/sample_controller32/Kconfig.defconfig"
osource "/home/mspatz/code/esp32_matter_led_controller/zephyr/soc/cdns/dc233c/Kconfig.defconfig"
osource "/home/mspatz/code/esp32_matter_led_controller/zephyr/soc/brcm/bcmvk/Kconfig.defconfig"
osource "/home/mspatz/code/esp32_matter_led_controller/zephyr/soc/brcm/bcm2712/Kconfig.defconfig"
osource "/home/mspatz/code/esp32_matter_led_controller/zephyr/soc/brcm/bcm2711/Kconfig.defconfig"
osource "/home/mspatz/code/esp32_matter_led_controller/zephyr/soc/bflb/Kconfig.defconfig"
osource "/home/mspatz/code/esp32_matter_led_controller/zephyr/soc/atmel/sam0/Kconfig.defconfig"
osource "/home/mspatz/code/esp32_matter_led_controller/zephyr/soc/atmel/sam/Kconfig.defconfig"
osource "/home/mspatz/code/esp32_matter_led_controller/zephyr/soc/aspeed/Kconfig.defconfig"
osource "/home/mspatz/code/esp32_matter_led_controller/zephyr/soc/arm/Kconfig.defconfig"
osource "/home/mspatz/code/esp32_matter_led_controller/zephyr/soc/arm/beetle/Kconfig.defconfig"
osource "/home/mspatz/code/esp32_matter_led_controller/zephyr/soc/antmicro/myra/Kconfig.defconfig"
osource "/home/mspatz/code/esp32_matter_led_controller/zephyr/soc/andestech/Kconfig.defconfig"
osource "/home/mspatz/code/esp32_matter_led_controller/zephyr/soc/amd/acp_6_0/Kconfig.defconfig"
osource "/home/mspatz/code/esp32_matter_led_controller/zephyr/soc/ambiq/Kconfig.defconfig"
osource "/home/mspatz/code/esp32_matter_led_controller/zephyr/soc/aesc/Kconfig.defconfig"
osource "/home/mspatz/code/esp32_matter_led_controller/zephyr/soc/adi/max32/Kconfig.defconfig"
```
