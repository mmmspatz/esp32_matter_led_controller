## twister-out.1/native_sim_native/host/tests/color_math/app.color_math/Kconfig/soc/Kconfig
```kconfig
# Load Zephyr SoC Kconfig descriptions.
osource "/home/mspatz/code/esp32_matter_led_controller/zephyr/soc/xlnx/zynqmp/Kconfig"
osource "/home/mspatz/code/esp32_matter_led_controller/zephyr/soc/xlnx/zynq7000/Kconfig"
osource "/home/mspatz/code/esp32_matter_led_controller/zephyr/soc/xlnx/versalnet/Kconfig"
osource "/home/mspatz/code/esp32_matter_led_controller/zephyr/soc/xlnx/versal2/Kconfig"
osource "/home/mspatz/code/esp32_matter_led_controller/zephyr/soc/xen/Kconfig"
osource "/home/mspatz/code/esp32_matter_led_controller/zephyr/soc/wch/ch32v/Kconfig"
osource "/home/mspatz/code/esp32_matter_led_controller/zephyr/soc/ti/simplelink/Kconfig"
osource "/home/mspatz/code/esp32_matter_led_controller/zephyr/soc/ti/mspm0/Kconfig"
osource "/home/mspatz/code/esp32_matter_led_controller/zephyr/soc/ti/lm3s6965/Kconfig"
osource "/home/mspatz/code/esp32_matter_led_controller/zephyr/soc/ti/k3/Kconfig"
osource "/home/mspatz/code/esp32_matter_led_controller/zephyr/soc/telink/tlsr/Kconfig"
osource "/home/mspatz/code/esp32_matter_led_controller/zephyr/soc/starfive/jh71xx/Kconfig"
osource "/home/mspatz/code/esp32_matter_led_controller/zephyr/soc/st/stm32/Kconfig"
osource "/home/mspatz/code/esp32_matter_led_controller/zephyr/soc/snps/qemu_arc/Kconfig"
osource "/home/mspatz/code/esp32_matter_led_controller/zephyr/soc/snps/nsim/arc_v/Kconfig"
osource "/home/mspatz/code/esp32_matter_led_controller/zephyr/soc/snps/nsim/arc_classic/Kconfig"
osource "/home/mspatz/code/esp32_matter_led_controller/zephyr/soc/snps/hsdk4xd/Kconfig"
osource "/home/mspatz/code/esp32_matter_led_controller/zephyr/soc/snps/hsdk/Kconfig"
osource "/home/mspatz/code/esp32_matter_led_controller/zephyr/soc/snps/emsk/Kconfig"
osource "/home/mspatz/code/esp32_matter_led_controller/zephyr/soc/snps/emsdp/Kconfig"
osource "/home/mspatz/code/esp32_matter_led_controller/zephyr/soc/snps/arc_iot/Kconfig"
osource "/home/mspatz/code/esp32_matter_led_controller/zephyr/soc/silabs/Kconfig"
osource "/home/mspatz/code/esp32_matter_led_controller/zephyr/soc/sifli/sf32/Kconfig"
osource "/home/mspatz/code/esp32_matter_led_controller/zephyr/soc/sifive/sifive_freedom/Kconfig"
osource "/home/mspatz/code/esp32_matter_led_controller/zephyr/soc/sensry/Kconfig"
osource "/home/mspatz/code/esp32_matter_led_controller/zephyr/soc/rockchip/Kconfig"
osource "/home/mspatz/code/esp32_matter_led_controller/zephyr/soc/renode/riscv_virtual/Kconfig"
osource "/home/mspatz/code/esp32_matter_led_controller/zephyr/soc/renode/cortex_r8_virtual/Kconfig"
osource "/home/mspatz/code/esp32_matter_led_controller/zephyr/soc/renesas/smartbond/Kconfig"
osource "/home/mspatz/code/esp32_matter_led_controller/zephyr/soc/renesas/rz/Kconfig"
osource "/home/mspatz/code/esp32_matter_led_controller/zephyr/soc/renesas/rx/Kconfig"
osource "/home/mspatz/code/esp32_matter_led_controller/zephyr/soc/renesas/rcar/Kconfig"
osource "/home/mspatz/code/esp32_matter_led_controller/zephyr/soc/renesas/ra/Kconfig"
osource "/home/mspatz/code/esp32_matter_led_controller/zephyr/soc/realtek/ec/Kconfig"
osource "/home/mspatz/code/esp32_matter_led_controller/zephyr/soc/raspberrypi/rpi_pico/Kconfig"
osource "/home/mspatz/code/esp32_matter_led_controller/zephyr/soc/quicklogic/eos_s3/Kconfig"
osource "/home/mspatz/code/esp32_matter_led_controller/zephyr/soc/qemu/virt_riscv/Kconfig"
osource "/home/mspatz/code/esp32_matter_led_controller/zephyr/soc/qemu/malta/Kconfig"
osource "/home/mspatz/code/esp32_matter_led_controller/zephyr/soc/openisa/rv32m1/Kconfig"
osource "/home/mspatz/code/esp32_matter_led_controller/zephyr/soc/openhwgroup/cva6/Kconfig"
osource "/home/mspatz/code/esp32_matter_led_controller/zephyr/soc/oct/osd32mp15x/Kconfig"
osource "/home/mspatz/code/esp32_matter_led_controller/zephyr/soc/nxp/s32/Kconfig"
osource "/home/mspatz/code/esp32_matter_led_controller/zephyr/soc/nxp/rw/Kconfig"
osource "/home/mspatz/code/esp32_matter_led_controller/zephyr/soc/nxp/mcx/Kconfig"
osource "/home/mspatz/code/esp32_matter_led_controller/zephyr/soc/nxp/lpc/Kconfig"
osource "/home/mspatz/code/esp32_matter_led_controller/zephyr/soc/nxp/layerscape/Kconfig"
osource "/home/mspatz/code/esp32_matter_led_controller/zephyr/soc/nxp/kinetis/Kconfig"
osource "/home/mspatz/code/esp32_matter_led_controller/zephyr/soc/nxp/imxrt/Kconfig"
osource "/home/mspatz/code/esp32_matter_led_controller/zephyr/soc/nxp/imx/Kconfig"
osource "/home/mspatz/code/esp32_matter_led_controller/zephyr/soc/nuvoton/numicro/Kconfig"
osource "/home/mspatz/code/esp32_matter_led_controller/zephyr/soc/nuvoton/numaker/Kconfig"
osource "/home/mspatz/code/esp32_matter_led_controller/zephyr/soc/nuvoton/npcx/Kconfig"
osource "/home/mspatz/code/esp32_matter_led_controller/zephyr/soc/nuvoton/npcm/Kconfig"
osource "/home/mspatz/code/esp32_matter_led_controller/zephyr/soc/nordic/Kconfig"
osource "/home/mspatz/code/esp32_matter_led_controller/zephyr/soc/neorv32/Kconfig"
osource "/home/mspatz/code/esp32_matter_led_controller/zephyr/soc/native/inf_clock/Kconfig"
osource "/home/mspatz/code/esp32_matter_led_controller/zephyr/soc/microchip/sam/Kconfig"
osource "/home/mspatz/code/esp32_matter_led_controller/zephyr/soc/microchip/sam/sama7/Kconfig"
osource "/home/mspatz/code/esp32_matter_led_controller/zephyr/soc/microchip/sam/sam_d5x_e5x/Kconfig"
osource "/home/mspatz/code/esp32_matter_led_controller/zephyr/soc/microchip/pic32c/pic32cz_ca/Kconfig"
osource "/home/mspatz/code/esp32_matter_led_controller/zephyr/soc/microchip/pic32c/pic32cx_sg/Kconfig"
osource "/home/mspatz/code/esp32_matter_led_controller/zephyr/soc/microchip/pic32c/pic32cm_jh/Kconfig"
osource "/home/mspatz/code/esp32_matter_led_controller/zephyr/soc/microchip/miv/Kconfig"
osource "/home/mspatz/code/esp32_matter_led_controller/zephyr/soc/microchip/mec/Kconfig"
osource "/home/mspatz/code/esp32_matter_led_controller/zephyr/soc/mediatek/mt8xxx/Kconfig"
osource "/home/mspatz/code/esp32_matter_led_controller/zephyr/soc/lowrisc/opentitan/Kconfig"
osource "/home/mspatz/code/esp32_matter_led_controller/zephyr/soc/litex/litex_vexriscv/Kconfig"
osource "/home/mspatz/code/esp32_matter_led_controller/zephyr/soc/ite/ec/Kconfig"
osource "/home/mspatz/code/esp32_matter_led_controller/zephyr/soc/intel/raptor_lake/Kconfig"
osource "/home/mspatz/code/esp32_matter_led_controller/zephyr/soc/intel/panther_lake/Kconfig"
osource "/home/mspatz/code/esp32_matter_led_controller/zephyr/soc/intel/lakemont/Kconfig"
osource "/home/mspatz/code/esp32_matter_led_controller/zephyr/soc/intel/intel_socfpga_std/Kconfig"
osource "/home/mspatz/code/esp32_matter_led_controller/zephyr/soc/intel/intel_socfpga/Kconfig"
osource "/home/mspatz/code/esp32_matter_led_controller/zephyr/soc/intel/intel_niosv/Kconfig"
osource "/home/mspatz/code/esp32_matter_led_controller/zephyr/soc/intel/intel_ish/Kconfig"
osource "/home/mspatz/code/esp32_matter_led_controller/zephyr/soc/intel/intel_adsp/Kconfig"
osource "/home/mspatz/code/esp32_matter_led_controller/zephyr/soc/intel/elkhart_lake/Kconfig"
osource "/home/mspatz/code/esp32_matter_led_controller/zephyr/soc/intel/atom/Kconfig"
osource "/home/mspatz/code/esp32_matter_led_controller/zephyr/soc/intel/apollo_lake/Kconfig"
osource "/home/mspatz/code/esp32_matter_led_controller/zephyr/soc/intel/alder_lake/Kconfig"
osource "/home/mspatz/code/esp32_matter_led_controller/zephyr/soc/infineon/edge/Kconfig"
osource "/home/mspatz/code/esp32_matter_led_controller/zephyr/soc/infineon/cat3/Kconfig"
osource "/home/mspatz/code/esp32_matter_led_controller/zephyr/soc/infineon/cat1c/Kconfig"
osource "/home/mspatz/code/esp32_matter_led_controller/zephyr/soc/infineon/cat1b/Kconfig"
osource "/home/mspatz/code/esp32_matter_led_controller/zephyr/soc/infineon/cat1a/Kconfig"
osource "/home/mspatz/code/esp32_matter_led_controller/zephyr/soc/gd/gd32/Kconfig"
osource "/home/mspatz/code/esp32_matter_led_controller/zephyr/soc/gaisler/leon3/Kconfig"
osource "/home/mspatz/code/esp32_matter_led_controller/zephyr/soc/gaisler/gr716a/Kconfig"
osource "/home/mspatz/code/esp32_matter_led_controller/zephyr/soc/espressif/Kconfig"
osource "/home/mspatz/code/esp32_matter_led_controller/zephyr/soc/ene/kb1200/Kconfig"
osource "/home/mspatz/code/esp32_matter_led_controller/zephyr/soc/ene/kb106x/Kconfig"
osource "/home/mspatz/code/esp32_matter_led_controller/zephyr/soc/egis/Kconfig"
osource "/home/mspatz/code/esp32_matter_led_controller/zephyr/soc/efinix/sapphire/Kconfig"
osource "/home/mspatz/code/esp32_matter_led_controller/zephyr/soc/cdns/xtensa_sample_controller/Kconfig"
osource "/home/mspatz/code/esp32_matter_led_controller/zephyr/soc/cdns/sample_controller32/Kconfig"
osource "/home/mspatz/code/esp32_matter_led_controller/zephyr/soc/cdns/dc233c/Kconfig"
osource "/home/mspatz/code/esp32_matter_led_controller/zephyr/soc/brcm/bcmvk/Kconfig"
osource "/home/mspatz/code/esp32_matter_led_controller/zephyr/soc/brcm/bcm2712/Kconfig"
osource "/home/mspatz/code/esp32_matter_led_controller/zephyr/soc/brcm/bcm2711/Kconfig"
osource "/home/mspatz/code/esp32_matter_led_controller/zephyr/soc/bflb/Kconfig"
osource "/home/mspatz/code/esp32_matter_led_controller/zephyr/soc/atmel/sam0/Kconfig"
osource "/home/mspatz/code/esp32_matter_led_controller/zephyr/soc/atmel/sam/Kconfig"
osource "/home/mspatz/code/esp32_matter_led_controller/zephyr/soc/aspeed/Kconfig"
osource "/home/mspatz/code/esp32_matter_led_controller/zephyr/soc/arm/Kconfig"
osource "/home/mspatz/code/esp32_matter_led_controller/zephyr/soc/arm/beetle/Kconfig"
osource "/home/mspatz/code/esp32_matter_led_controller/zephyr/soc/antmicro/myra/Kconfig"
osource "/home/mspatz/code/esp32_matter_led_controller/zephyr/soc/andestech/Kconfig"
osource "/home/mspatz/code/esp32_matter_led_controller/zephyr/soc/amd/acp_6_0/Kconfig"
osource "/home/mspatz/code/esp32_matter_led_controller/zephyr/soc/ambiq/Kconfig"
osource "/home/mspatz/code/esp32_matter_led_controller/zephyr/soc/aesc/Kconfig"
osource "/home/mspatz/code/esp32_matter_led_controller/zephyr/soc/adi/max32/Kconfig"
```
