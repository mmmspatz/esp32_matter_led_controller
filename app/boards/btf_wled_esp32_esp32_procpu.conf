## twister-out.1/native_sim_native/host/tests/color_math/app.color_math/Kconfig/soc/Kconfig.sysbuild
```kconfig
# Load Sysbuild SoC Kconfig descriptions.
osource "/home/mspatz/code/esp32_matter_led_controller/zephyr/soc/xlnx/zynqmp/Kconfig.sysbuild"
osource "/home/mspatz/code/esp32_matter_led_controller/zephyr/soc/xlnx/zynq7000/Kconfig.sysbuild"
osource "/home/mspatz/code/esp32_matter_led_controller/zephyr/soc/xlnx/versalnet/Kconfig.sysbuild"
osource "/home/mspatz/code/esp32_matter_led_controller/zephyr/soc/xlnx/versal2/Kconfig.sysbuild"
osource "/home/mspatz/code/esp32_matter_led_controller/zephyr/soc/xen/Kconfig.sysbuild"
osource "/home/mspatz/code/esp32_matter_led_controller/zephyr/soc/wch/ch32v/Kconfig.sysbuild"
osource "/home/mspatz/code/esp32_matter_led_controller/zephyr/soc/ti/simplelink/Kconfig.sysbuild"
osource "/home/mspatz/code/esp32_matter_led_controller/zephyr/soc/ti/mspm0/Kconfig.sysbuild"
osource "/home/mspatz/code/esp32_matter_led_controller/zephyr/soc/ti/lm3s6965/Kconfig.sysbuild"
osource "/home/mspatz/code/esp32_matter_led_controller/zephyr/soc/ti/k3/Kconfig.sysbuild"
osource "/home/mspatz/code/esp32_matter_led_controller/zephyr/soc/telink/tlsr/Kconfig.sysbuild"
osource "/home/mspatz/code/esp32_matter_led_controller/zephyr/soc/starfive/jh71xx/Kconfig.sysbuild"
osource "/home/mspatz/code/esp32_matter_led_controller/zephyr/soc/st/stm32/Kconfig.sysbuild"
osource "/home/mspatz/code/esp32_matter_led_controller/zephyr/soc/snps/qemu_arc/Kconfig.sysbuild"
osource "/home/mspatz/code/esp32_matter_led_controller/zephyr/soc/snps/nsim/arc_v/Kconfig.sysbuild"
osource "/home/mspatz/code/esp32_matter_led_controller/zephyr/soc/snps/nsim/arc_classic/Kconfig.sysbuild"
osource "/home/mspatz/code/esp32_matter_led_controller/zephyr/soc/snps/hsdk4xd/Kconfig.sysbuild"
osource "/home/mspatz/code/esp32_matter_led_controller/zephyr/soc/snps/hsdk/Kconfig.sysbuild"
osource "/home/mspatz/code/esp32_matter_led_controller/zephyr/soc/snps/emsk/Kconfig.sysbuild"
osource "/home/mspatz/code/esp32_matter_led_controller/zephyr/soc/snps/emsdp/Kconfig.sysbuild"
osource "/home/mspatz/code/esp32_matter_led_controller/zephyr/soc/snps/arc_iot/Kconfig.sysbuild"
osource "/home/mspatz/code/esp32_matter_led_controller/zephyr/soc/silabs/Kconfig.sysbuild"
osource "/home/mspatz/code/esp32_matter_led_controller/zephyr/soc/sifli/sf32/Kconfig.sysbuild"
osource "/home/mspatz/code/esp32_matter_led_controller/zephyr/soc/sifive/sifive_freedom/Kconfig.sysbuild"
osource "/home/mspatz/code/esp32_matter_led_controller/zephyr/soc/sensry/Kconfig.sysbuild"
osource "/home/mspatz/code/esp32_matter_led_controller/zephyr/soc/rockchip/Kconfig.sysbuild"
osource "/home/mspatz/code/esp32_matter_led_controller/zephyr/soc/renode/riscv_virtual/Kconfig.sysbuild"
osource "/home/mspatz/code/esp32_matter_led_controller/zephyr/soc/renode/cortex_r8_virtual/Kconfig.sysbuild"
osource "/home/mspatz/code/esp32_matter_led_controller/zephyr/soc/renesas/smartbond/Kconfig.sysbuild"
osource "/home/mspatz/code/esp32_matter_led_controller/zephyr/soc/renesas/rz/Kconfig.sysbuild"
osource "/home/mspatz/code/esp32_matter_led_controller/zephyr/soc/renesas/rx/Kconfig.sysbuild"
osource "/home/mspatz/code/esp32_matter_led_controller/zephyr/soc/renesas/rcar/Kconfig.sysbuild"
osource "/home/mspatz/code/esp32_matter_led_controller/zephyr/soc/renesas/ra/Kconfig.sysbuild"
osource "/home/mspatz/code/esp32_matter_led_controller/zephyr/soc/realtek/ec/Kconfig.sysbuild"
osource "/home/mspatz/code/esp32_matter_led_controller/zephyr/soc/raspberrypi/rpi_pico/Kconfig.sysbuild"
osource "/home/mspatz/code/esp32_matter_led_controller/zephyr/soc/quicklogic/eos_s3/Kconfig.sysbuild"
osource "/home/mspatz/code/esp32_matter_led_controller/zephyr/soc/qemu/virt_riscv/Kconfig.sysbuild"
osource "/home/mspatz/code/esp32_matter_led_controller/zephyr/soc/qemu/malta/Kconfig.sysbuild"
osource "/home/mspatz/code/esp32_matter_led_controller/zephyr/soc/openisa/rv32m1/Kconfig.sysbuild"
osource "/home/mspatz/code/esp32_matter_led_controller/zephyr/soc/openhwgroup/cva6/Kconfig.sysbuild"
osource "/home/mspatz/code/esp32_matter_led_controller/zephyr/soc/oct/osd32mp15x/Kconfig.sysbuild"
osource "/home/mspatz/code/esp32_matter_led_controller/zephyr/soc/nxp/s32/Kconfig.sysbuild"
osource "/home/mspatz/code/esp32_matter_led_controller/zephyr/soc/nxp/rw/Kconfig.sysbuild"
osource "/home/mspatz/code/esp32_matter_led_controller/zephyr/soc/nxp/mcx/Kconfig.sysbuild"
osource "/home/mspatz/code/esp32_matter_led_controller/zephyr/soc/nxp/lpc/Kconfig.sysbuild"
osource "/home/mspatz/code/esp32_matter_led_controller/zephyr/soc/nxp/layerscape/Kconfig.sysbuild"
osource "/home/mspatz/code/esp32_matter_led_controller/zephyr/soc/nxp/kinetis/Kconfig.sysbuild"
osource "/home/mspatz/code/esp32_matter_led_controller/zephyr/soc/nxp/imxrt/Kconfig.sysbuild"
osource "/home/mspatz/code/esp32_matter_led_controller/zephyr/soc/nxp/imx/Kconfig.sysbuild"
osource "/home/mspatz/code/esp32_matter_led_controller/zephyr/soc/nuvoton/numicro/Kconfig.sysbuild"
osource "/home/mspatz/code/esp32_matter_led_controller/zephyr/soc/nuvoton/numaker/Kconfig.sysbuild"
osource "/home/mspatz/code/esp32_matter_led_controller/zephyr/soc/nuvoton/npcx/Kconfig.sysbuild"
osource "/home/mspatz/code/esp32_matter_led_controller/zephyr/soc/nuvoton/npcm/Kconfig.sysbuild"
osource "/home/mspatz/code/esp32_matter_led_controller/zephyr/soc/nordic/Kconfig.sysbuild"
osource "/home/mspatz/code/esp32_matter_led_controller/zephyr/soc/neorv32/Kconfig.sysbuild"
osource "/home/mspatz/code/esp32_matter_led_controller/zephyr/soc/native/inf_clock/Kconfig.sysbuild"
osource "/home/mspatz/code/esp32_matter_led_controller/zephyr/soc/microchip/sam/Kconfig.sysbuild"
osource "/home/mspatz/code/esp32_matter_led_controller/zephyr/soc/microchip/sam/sama7/Kconfig.sysbuild"
osource "/home/mspatz/code/esp32_matter_led_controller/zephyr/soc/microchip/sam/sam_d5x_e5x/Kconfig.sysbuild"
osource "/home/mspatz/code/esp32_matter_led_controller/zephyr/soc/microchip/pic32c/pic32cz_ca/Kconfig.sysbuild"
osource "/home/mspatz/code/esp32_matter_led_controller/zephyr/soc/microchip/pic32c/pic32cx_sg/Kconfig.sysbuild"
osource "/home/mspatz/code/esp32_matter_led_controller/zephyr/soc/microchip/pic32c/pic32cm_jh/Kconfig.sysbuild"
osource "/home/mspatz/code/esp32_matter_led_controller/zephyr/soc/microchip/miv/Kconfig.sysbuild"
osource "/home/mspatz/code/esp32_matter_led_controller/zephyr/soc/microchip/mec/Kconfig.sysbuild"
osource "/home/mspatz/code/esp32_matter_led_controller/zephyr/soc/mediatek/mt8xxx/Kconfig.sysbuild"
osource "/home/mspatz/code/esp32_matter_led_controller/zephyr/soc/lowrisc/opentitan/Kconfig.sysbuild"
osource "/home/mspatz/code/esp32_matter_led_controller/zephyr/soc/litex/litex_vexriscv/Kconfig.sysbuild"
osource "/home/mspatz/code/esp32_matter_led_controller/zephyr/soc/ite/ec/Kconfig.sysbuild"
osource "/home/mspatz/code/esp32_matter_led_controller/zephyr/soc/intel/raptor_lake/Kconfig.sysbuild"
osource "/home/mspatz/code/esp32_matter_led_controller/zephyr/soc/intel/panther_lake/Kconfig.sysbuild"
osource "/home/mspatz/code/esp32_matter_led_controller/zephyr/soc/intel/lakemont/Kconfig.sysbuild"
osource "/home/mspatz/code/esp32_matter_led_controller/zephyr/soc/intel/intel_socfpga_std/Kconfig.sysbuild"
osource "/home/mspatz/code/esp32_matter_led_controller/zephyr/soc/intel/intel_socfpga/Kconfig.sysbuild"
osource "/home/mspatz/code/esp32_matter_led_controller/zephyr/soc/intel/intel_niosv/Kconfig.sysbuild"
osource "/home/mspatz/code/esp32_matter_led_controller/zephyr/soc/intel/intel_ish/Kconfig.sysbuild"
osource "/home/mspatz/code/esp32_matter_led_controller/zephyr/soc/intel/intel_adsp/Kconfig.sysbuild"
osource "/home/mspatz/code/esp32_matter_led_controller/zephyr/soc/intel/elkhart_lake/Kconfig.sysbuild"
osource "/home/mspatz/code/esp32_matter_led_controller/zephyr/soc/intel/atom/Kconfig.sysbuild"
osource "/home/mspatz/code/esp32_matter_led_controller/zephyr/soc/intel/apollo_lake/Kconfig.sysbuild"
osource "/home/mspatz/code/esp32_matter_led_controller/zephyr/soc/intel/alder_lake/Kconfig.sysbuild"
osource "/home/mspatz/code/esp32_matter_led_controller/zephyr/soc/infineon/edge/Kconfig.sysbuild"
osource "/home/mspatz/code/esp32_matter_led_controller/zephyr/soc/infineon/cat3/Kconfig.sysbuild"
osource "/home/mspatz/code/esp32_matter_led_controller/zephyr/soc/infineon/cat1c/Kconfig.sysbuild"
osource "/home/mspatz/code/esp32_matter_led_controller/zephyr/soc/infineon/cat1b/Kconfig.sysbuild"
osource "/home/mspatz/code/esp32_matter_led_controller/zephyr/soc/infineon/cat1a/Kconfig.sysbuild"
osource "/home/mspatz/code/esp32_matter_led_controller/zephyr/soc/gd/gd32/Kconfig.sysbuild"
osource "/home/mspatz/code/esp32_matter_led_controller/zephyr/soc/gaisler/leon3/Kconfig.sysbuild"
osource "/home/mspatz/code/esp32_matter_led_controller/zephyr/soc/gaisler/gr716a/Kconfig.sysbuild"
osource "/home/mspatz/code/esp32_matter_led_controller/zephyr/soc/espressif/Kconfig.sysbuild"
osource "/home/mspatz/code/esp32_matter_led_controller/zephyr/soc/ene/kb1200/Kconfig.sysbuild"
osource "/home/mspatz/code/esp32_matter_led_controller/zephyr/soc/ene/kb106x/Kconfig.sysbuild"
osource "/home/mspatz/code/esp32_matter_led_controller/zephyr/soc/egis/Kconfig.sysbuild"
osource "/home/mspatz/code/esp32_matter_led_controller/zephyr/soc/efinix/sapphire/Kconfig.sysbuild"
osource "/home/mspatz/code/esp32_matter_led_controller/zephyr/soc/cdns/xtensa_sample_controller/Kconfig.sysbuild"
osource "/home/mspatz/code/esp32_matter_led_controller/zephyr/soc/cdns/sample_controller32/Kconfig.sysbuild"
osource "/home/mspatz/code/esp32_matter_led_controller/zephyr/soc/cdns/dc233c/Kconfig.sysbuild"
osource "/home/mspatz/code/esp32_matter_led_controller/zephyr/soc/brcm/bcmvk/Kconfig.sysbuild"
osource "/home/mspatz/code/esp32_matter_led_controller/zephyr/soc/brcm/bcm2712/Kconfig.sysbuild"
osource "/home/mspatz/code/esp32_matter_led_controller/zephyr/soc/brcm/bcm2711/Kconfig.sysbuild"
osource "/home/mspatz/code/esp32_matter_led_controller/zephyr/soc/bflb/Kconfig.sysbuild"
osource "/home/mspatz/code/esp32_matter_led_controller/zephyr/soc/atmel/sam0/Kconfig.sysbuild"
osource "/home/mspatz/code/esp32_matter_led_controller/zephyr/soc/atmel/sam/Kconfig.sysbuild"
osource "/home/mspatz/code/esp32_matter_led_controller/zephyr/soc/aspeed/Kconfig.sysbuild"
osource "/home/mspatz/code/esp32_matter_led_controller/zephyr/soc/arm/Kconfig.sysbuild"
osource "/home/mspatz/code/esp32_matter_led_controller/zephyr/soc/arm/beetle/Kconfig.sysbuild"
osource "/home/mspatz/code/esp32_matter_led_controller/zephyr/soc/antmicro/myra/Kconfig.sysbuild"
osource "/home/mspatz/code/esp32_matter_led_controller/zephyr/soc/andestech/Kconfig.sysbuild"
osource "/home/mspatz/code/esp32_matter_led_controller/zephyr/soc/amd/acp_6_0/Kconfig.sysbuild"
osource "/home/mspatz/code/esp32_matter_led_controller/zephyr/soc/ambiq/Kconfig.sysbuild"
osource "/home/mspatz/code/esp32_matter_led_controller/zephyr/soc/aesc/Kconfig.sysbuild"
osource "/home/mspatz/code/esp32_matter_led_controller/zephyr/soc/adi/max32/Kconfig.sysbuild"
```

## twister-out/native_sim_native_64/host/tests/color_math/app.color_math/Kconfig/Kconfig.modules
```kconfig
config ZEPHYR_ESP32_MATTER_LED_CONTROLLER_MODULE
	bool
	default y
menu "hal_espressif (/home/mspatz/code/esp32_matter_led_controller/modules/hal/espressif)"
osource "/home/mspatz/code/esp32_matter_led_controller/modules/hal/espressif/zephyr/Kconfig"
config ZEPHYR_HAL_ESPRESSIF_MODULE
	bool
	default y
	select TAINT_BLOBS

config ZEPHYR_HAL_ESPRESSIF_MODULE_BLOBS
	bool
	default y
endmenu
menu "mbedtls (/home/mspatz/code/esp32_matter_led_controller/modules/crypto/mbedtls)"
osource "$(ZEPHYR_MBEDTLS_KCONFIG)"
config ZEPHYR_MBEDTLS_MODULE
	bool
	default y
endmenu
config ZEPHYR_MCUBOOT_MODULE
	bool
	default y
menu "openthread (/home/mspatz/code/esp32_matter_led_controller/modules/lib/openthread)"
osource "$(ZEPHYR_OPENTHREAD_KCONFIG)"
config ZEPHYR_OPENTHREAD_MODULE
	bool
	default y
endmenu
menu "picolibc (/home/mspatz/code/esp32_matter_led_controller/modules/lib/picolibc)"
osource "/home/mspatz/code/esp32_matter_led_controller/modules/lib/picolibc/zephyr/Kconfig"
config ZEPHYR_PICOLIBC_MODULE
	bool
	default y
endmenu
```

## twister-out/native_sim_native_64/host/tests/color_math/app.color_math/Kconfig/Kconfig.sysbuild.modules
```kconfig
config ZEPHYR_ESP32_MATTER_LED_CONTROLLER_MODULE
   bool
   default y
config ZEPHYR_HAL_ESPRESSIF_MODULE
   bool
   default y
config ZEPHYR_MBEDTLS_MODULE
   bool
   default y
config ZEPHYR_MCUBOOT_MODULE
   bool
   default y
config ZEPHYR_OPENTHREAD_MODULE
   bool
   default y
config ZEPHYR_PICOLIBC_MODULE
   bool
   default y
```
