## CMakeLists.txt
```
# SPDX-License-Identifier: Apache-2.0

cmake_minimum_required(VERSION 3.20.0)

# The Zephyr module list is fixed at find_package time, so registering
# CHIP's chip-module (its Kconfig tree + the GN ExternalProject that builds
# libCHIP.a) is the one thing that must happen first.
get_filename_component(CHIP_ROOT ${CMAKE_CURRENT_SOURCE_DIR}/../modules/connectedhomeip REALPATH)
list(APPEND ZEPHYR_EXTRA_MODULES ${CHIP_ROOT}/config/zephyr/chip-module)

find_package(Zephyr HINTS $ENV{ZEPHYR_BASE})


# unused-result: the reused example scaffold ignores a nodiscard
# CHIP_ERROR on the WiFi path; not our code to fix here.
target_compile_options(app PRIVATE -Werror -Wno-error=maybe-uninitialized -Wno-error=unused-result)
target_compile_options(app PRIVATE -Wdouble-promotion -Werror=double-promotion)

project(esp32_matter_led_controller)

include(${CHIP_ROOT}/config/zephyr/app/enable-gnu-std.cmake)
include(${CHIP_ROOT}/src/app/chip_data_model.cmake)

target_include_directories(app
    PRIVATE
    include
    src
    src/scaffold
)

# src/scaffold is CHIP's examples/platform/silabs/zephyr app scaffold
# (generic despite the upstream path), vendored so we own its bugfixes —
# notably NetworkCommissioning registration ordering in AppTaskBase.cpp.
target_sources(app
    PRIVATE
    src/AppTask.cpp
    src/DeviceCallbacks.cpp
    src/LightingManager.cpp
    src/color_math.c
    src/led_pwm.c
    src/scaffold/main.cpp
    src/scaffold/AppTaskBase.cpp
    src/scaffold/AppTaskZephyr.cpp
    src/scaffold/CHIPDeviceManager.cpp
    src/scaffold/CommonDeviceCallbacks.cpp
    # Without this file cluster attribute writes silently no-op (it defines
    # MatterPostAttributeChangeCallback and routes it to DeviceCallbacks).
    src/scaffold/DataModelCallbacks.cpp
)

# Classic ESP32 only: its WiFi blob adapter (hal_espressif esp32/esp_adapter.c)
# defines a strong random(), colliding with picolibc's srand chain; the shim
# keeps picolibc's random.o out of the link. The C6 adapter defines no such
# symbol (verified against hal_espressif esp32c6/esp_adapter.c and the C6 blobs).
if(CONFIG_SOC_SERIES_ESP32)
    target_sources(app PRIVATE src/rand_shim.c)
endif()

# C6 only: PSA transparent driver feeding P-256 point multiplication to the
# ECC accelerator. The dispatch hook lives in the tf-psa-crypto module
# (patches/tf-psa-crypto/0001); the enable macro and esp_ecc_psa_driver.h
# reach the tfpsacrypto external library through zephyr_interface (its
# usage requirements resolve at generate time, after this file). Keep both
# OFF the Kconfig/user-config route: anything in autoconf.h or the
# TF-PSA-Crypto config chain leaks into CHIP's GN build, whose include
# dirs are snapshotted before this file runs and cannot see app headers.
# esp_ecc.c/ecc_hal.c are hal_espressif files its Zephyr glue doesn't
# build; the lock/clock services they expect are supplied by
# esp_crypto_shims.c.
if(CONFIG_LEDCTRL_PSA_ESP_ECC_DRIVER)
    zephyr_compile_definitions(MBEDTLS_PSA_ESP_ECC_DRIVER_ENABLED)
    zephyr_include_directories(src/crypto/include)
    target_include_directories(app PRIVATE
        ${ZEPHYR_HAL_ESPRESSIF_MODULE_DIR}/components/mbedtls/port/include
        ${ZEPHYR_TF_PSA_CRYPTO_MODULE_DIR}/include
        ${ZEPHYR_TF_PSA_CRYPTO_MODULE_DIR}/drivers/builtin/include
    )
    target_sources(app PRIVATE
        src/crypto/esp_ecc_psa_driver.c
        src/crypto/esp_crypto_shims.c
        ${ZEPHYR_HAL_ESPRESSIF_MODULE_DIR}/components/mbedtls/port/ecc/esp_ecc.c
        ${ZEPHYR_HAL_ESPRESSIF_MODULE_DIR}/components/esp_hal_security/ecc_hal.c
    )
endif()

# OTA Requestor glue, vendored verbatim from CHIP's examples/platform/silabs/
# zephyr/ota_requestor (pin 9d45993e3f) so we own it alongside the rest of the
# scaffold. Re-diff against upstream when re-pinning.
if(CONFIG_CHIP_OTA_REQUESTOR)
    target_include_directories(app PRIVATE src/scaffold/ota_requestor/include)
    target_sources(app PRIVATE
        src/scaffold/ota_requestor/source/OTARequestorInitiatorCommon.cpp
        src/scaffold/ota_requestor/source/OTARequestorInitiatorZephyr.cpp
    )
endif()

if(CONFIG_LEDCTRL_PROV_SHELL)
    target_sources(app PRIVATE src/ProvisionShell.cpp)
endif()

if(CONFIG_LEDCTRL_WIFI_CREDS_SHELL)
    target_sources(app PRIVATE src/WifiCredsShell.cpp)
endif()

# Heap-stats diagnostic: available in any image that has the shell.
if(CONFIG_SHELL)
    target_sources(app PRIVATE src/HeapStatsShell.cpp)
endif()

if(CONFIG_LEDCTRL_MODE_RGB)
    set(LEDCTRL_ZAP_FILE ${CMAKE_CURRENT_SOURCE_DIR}/data_model/rgb_light.zap)
else()
    set(LEDCTRL_ZAP_FILE ${CMAKE_CURRENT_SOURCE_DIR}/data_model/lighting.zap)
endif()

chip_configure_data_model(app
    ZAP_FILE ${LEDCTRL_ZAP_FILE}
    ZCL_PATH ${CHIP_ROOT}/src/app/zap-templates/zcl/zcl.json
)
```

## Kconfig
```
# SPDX-License-Identifier: Apache-2.0

# chip-module's Kconfig.defaults (rsourced below) re-declares FPU with a
# bare "default y" and no dependency. On an FPU-less core (the C6's
# rv32imac) CPU_HAS_FPU=n hides the arch prompt, so .conf assignments are
# IGNORED and that default wins -- the RISC-V reset.S then fails to
# assemble (fscsr needs the F extension). Declare a guarded default first
# (first satisfied default wins; this file parses before the rsource's
# tree): no FPU without hardware. FPU-equipped SoCs fall through to y.
config FPU
	bool
	default n if !CPU_HAS_FPU

# --- Matter operational transport: WiFi vs Thread (build-time) -------------
# The one 2.4 GHz radio can be WiFi OR 802.15.4 as the operational network,
# not both; BLE stays for commissioning either way. Thread is C6-only -- the
# classic ESP32-WROOM-32E has no 802.15.4 radio. Modeled like LEDCTRL_MODE
# (CCT/RGB): a Kconfig choice whose transport-conditional re-defaults are
# declared HERE, before the chip-module rsource and Kconfig.zephyr, so "first
# satisfied default wins" overrides the upstream defaults with no
# conflicting-value warnings (these are conditional defaults, not =y/=n
# assignments -- an inactive branch leaves the upstream default in place).
choice LEDCTRL_TRANSPORT
	prompt "Matter operational transport"
	default LEDCTRL_TRANSPORT_THREAD if SOC_SERIES_ESP32C6
	default LEDCTRL_TRANSPORT_WIFI

config LEDCTRL_TRANSPORT_WIFI
	bool "WiFi (station)"

config LEDCTRL_TRANSPORT_THREAD
	bool "Thread (802.15.4)"
	depends on SOC_SERIES_ESP32C6
	help
	  Matter-over-Thread: the OpenThread FTD stack over the esp32 802.15.4
	  radio. Requires the ieee802154 devicetree node enabled -- the C6 board
	  DTS does so by default; the wifi.conf/wifi.overlay variant flips back
	  to WiFi.

endchoice

# WiFi transport: the CHIP WiFi command set + the Zephyr WiFi driver, plus the
# neighbor-discovery / stats bits CHIP's WiFiManager (router solicitation) and
# DiagnosticDataProviderImplWiFi need. chip-module's Kconfig.defaults disables
# these (its Thread bias); re-enable them only for the WiFi transport.
config CHIP_WIFI
	default y if LEDCTRL_TRANSPORT_WIFI
	default n

config CHIP_ENABLE_WIFI_STATION
	default y if LEDCTRL_TRANSPORT_WIFI

config WIFI
	default y if LEDCTRL_TRANSPORT_WIFI
	default n

config NET_IPV6_NBR_CACHE
	default y if LEDCTRL_TRANSPORT_WIFI

config NET_IPV6_ND
	default y if LEDCTRL_TRANSPORT_WIFI

config NET_STATISTICS
	default y if LEDCTRL_TRANSPORT_WIFI

config NET_STATISTICS_WIFI
	default y if LEDCTRL_TRANSPORT_WIFI

config NET_STATISTICS_USER_API
	default y if LEDCTRL_TRANSPORT_WIFI

# Thread transport: NET_L2_OPENTHREAD selects OPENTHREAD + the 802.15.4 subsys
# (the esp32 radio driver auto-enables from the DT node). The NXP Thread
# defaults are inactive on this SoC (chip-module's Kconfig.defaults wraps them
# in `if SOC_FAMILY_NXP_RW`), so the FTD-correct options are set explicitly --
# the base OpenThread defaults (SLAAC off, Thread 1.1, MANUAL_START off) are
# wrong for Matter.
config NET_L2_OPENTHREAD
	default y if LEDCTRL_TRANSPORT_THREAD
	default n

config CHIP_OPENTHREAD_FTD
	default y if LEDCTRL_TRANSPORT_THREAD

# Matter commits the commissioned Operational Dataset and starts Thread
# itself; without manual start the L2 auto-attaches to a default network
# (~28 s stall before Matter takes over).
config OPENTHREAD_MANUAL_START
	default y if LEDCTRL_TRANSPORT_THREAD

# Form an off-mesh-routable (OMR/GUA) address from the border router's on-mesh
# prefix -- Matter operational traffic routed through the BR needs it.
config OPENTHREAD_SLAAC
	default y if LEDCTRL_TRANSPORT_THREAD

# BLE (commissioning) + 802.15.4 (operational) share the one 2.4 GHz radio;
# software coexistence arbitrates them during the commissioning->Thread
# handoff. The SoC already defaults this y for IEEE802154_ESP32 && BT_ESP32
# (zephyr/soc/espressif/common/Kconfig); pin it to intent.
config ESP32_SW_COEXIST_ENABLE
	default y if LEDCTRL_TRANSPORT_THREAD && BT

# Router-eligible FTD (mains-powered, not a sleepy MTD) and Thread 1.4 (Matter
# expects 1.3+; base OpenThread default is 1.1). Named choices re-opened to add
# a transport-conditional default, parsed before the upstream definition so it
# wins. (OPENTHREAD_DEVICE_TYPE already defaults to FTD as its first member, so
# only CHIP_OPENTHREAD_FTD above needs pinning for the GN arg; the version
# choice genuinely needs the bump.)
choice OPENTHREAD_STACK_VERSION
	default OPENTHREAD_THREAD_VERSION_1_4 if LEDCTRL_TRANSPORT_THREAD
endchoice
# ---------------------------------------------------------------------------

# Opt into CHIP's Zephyr defaults (deterministic workspace-relative path;
# orsource with env vars silently no-ops). Its Thread-biased defaults are
# overridden above per the selected LEDCTRL_TRANSPORT (notably
# NET_L2_OPENTHREAD, which chip-module defaults y).
rsource "../modules/connectedhomeip/config/zephyr/chip-module/Kconfig.defaults"

# The Espressif WiFi/BT drivers contribute promptless HEAP_MEM_POOL_ADD_SIZE_*
# defaults (40960 + 25600 on Zephyr 4.3; 4.4 raises WiFi to 51200 citing
# real allocation failures) that set the floor of the statically-allocated
# kernel heap — above measured need on the classic ESP32 (peak ~42K with
# both radios active and trimmed driver buffers). Kconfig takes the first
# default it sees, and this file is parsed before the driver tree, so
# re-declaring the symbols here lowers the floor. dram0_0_seg is 136K
# total; every KB counts. Re-measure before trusting these numbers on a
# new Zephyr/hal pin. Classic ESP32 only: the C6's unified 512K SRAM
# doesn't need the diet, so it keeps the driver defaults (51200 + 50000).
config HEAP_MEM_POOL_ADD_SIZE_ESP_WIFI
	int
	default 24576 if SOC_SERIES_ESP32

config HEAP_MEM_POOL_ADD_SIZE_ESP_BT
	int
	default 16384 if SOC_SERIES_ESP32

choice LEDCTRL_MODE
	prompt "LED strip type"
	default LEDCTRL_MODE_CCT

config LEDCTRL_MODE_CCT
	bool "2-channel tunable white (CCT) strip"

config LEDCTRL_MODE_RGB
	bool "3-channel RGB strip"

endchoice

config LEDCTRL_PROV_SHELL
	bool "Pairing-code provisioning shell commands"
	depends on SHELL
	select HWINFO
	help
	  matter_prov set/show/clear commands writing the chip-fct settings
	  keys read by the commissionable-data provider (and reporting the
	  eFuse device ID that provision.py files its records under).

	  On the C6 this is enabled in the production image (board conf):
	  512K SRAM has room for the shell alongside BT, so a board is
	  provisioned in place over the console. On the classic ESP32 dram0
	  does not allow it, so the shell arrives via the BT-less prov.conf
	  variant: flash prov, provision, then flash the production image
	  (the settings partition survives reflashing).

config LEDCTRL_WIFI_CREDS_SHELL
	bool "WiFi credential injection shell commands"
	depends on SHELL && CHIP_WIFI
	help
	  matter_wifi set/show/clear commands writing the WiFi station
	  credentials that ZephyrWifiDriver persists (its two g/wi KVS keys)
	  and that normally only a commissioning session produces.

	  The recovery case this exists for: a board that already holds a
	  fabric but no credentials -- commissioned over Thread, then
	  reflashed with the WiFi transport. It boots commissioned, so CHIP
	  disables BLE advertising instead of opening a commissioning window,
	  and NetworkCommissioning is only reachable over the network it
	  cannot join. Without this the only way out is a factory reset.

	  Bench tooling: takes the PSK in plaintext over the console.

if LEDCTRL_MODE_CCT

config LEDCTRL_CH_WARM
	int "led_pwm channel index of the warm-white strip channel"
	default 1

config LEDCTRL_CH_COOL
	int "led_pwm channel index of the cool-white strip channel"
	default 0

config LEDCTRL_MIREDS_COOL
	int "Coolest supported color temperature (mireds)"
	default 154

config LEDCTRL_MIREDS_WARM
	int "Warmest supported color temperature (mireds)"
	default 370

endif # LEDCTRL_MODE_CCT

config LEDCTRL_RECLAIM_BT_DRAM_AFTER_COMMISSIONING
	bool "Reclaim the BT-controller DRAM reserve after commissioning"
	depends on BT && CHIP_MALLOC_SYS_HEAP && SOC_SERIES_ESP32
	default y
	select MULTI_HEAP
	select SYS_HEAP_RUNTIME_STATS
	help
	  After the device is fully provisioned and joined to WiFi, tear down the
	  BLE stack (bt_disable) and hand the ~54.8 KiB CONFIG_ESP32_BT_RESERVE_DRAM
	  region to the CHIP sys_heap as a second heap bank (see
	  patches/connectedhomeip 0002/0006). This makes BLE a one-way,
	  commissioning-only resource: it CANNOT be re-enabled without a
	  reboot, so additional-fabric commissioning must happen on-network
	  (PASE over IP, which commissioners support). A factory reset
	  reboots, restoring BLE for re-commissioning.

config LEDCTRL_PSA_ESP_ECC_DRIVER
	bool "P-256 point multiplication on the ECC accelerator"
	depends on SOC_SERIES_ESP32C6 && CHIP_CRYPTO_PSA
	default y
	help
	  Register a PSA transparent driver (app/src/crypto, dispatch hook in
	  patches/tf-psa-crypto/0001) that feeds P-256 point multiplication to
	  the C6's ECC engine: CASE ECDH, ECDSA sign and verify, and
	  public-key derivation. SPAKE2+ stays on the builtin software path,
	  which remains fully compiled — the driver deliberately defines no
	  MBEDTLS_PSA_ACCEL_* macros, and rare verify corner cases fall back
	  to it.

source "Kconfig.zephyr"
```

## sysbuild.conf
```
# Sysbuild config: build MCUboot as the second-stage bootloader so the CHIP
# Zephyr OTA image processor (slot1 stream_flash + boot_request_upgrade) has a
# bootloader that can switch slots. Setting BOOTLOADER_MCUBOOT propagates
# CONFIG_BOOTLOADER_MCUBOOT=y into the app image, which auto-disables
# ESP_SIMPLE_BOOT.
SB_CONFIG_BOOTLOADER_MCUBOOT=y

# Overwrite-only: the 4M partition table has no scratch, and the Espressif
# esp32_procpu MCUboot overlay forces BOOT_UPGRADE_ONLY=y. The ESP32 sysbuild
# mode default is swap-using-move, so pin overwrite-only explicitly to keep the
# app-side mode aligned with the bootloader. (No auto-revert; bad image = USB
# reflash. Swap-with-rollback is a deliberate later step.)
SB_CONFIG_MCUBOOT_MODE_OVERWRITE_ONLY=y

# Image signing: ECDSA-P256. MCUboot validates the secondary slot's signature
# before swapping, so the OTA image (and slot0) must be signed with this key.
# sysbuild's BOOTLOADER_image_default.cmake force-sets the MCUboot image's
# CONFIG_BOOT_SIGNATURE_TYPE_* from this SB symbol (it overrides the
# esp32_procpu.conf overlay). The verify IMPLEMENTATION (PSA, not the default
# tinycrypt) plus the heap/PSA-init fixes live in sysbuild/mcuboot.conf +
# patches/mcuboot/0001 — see that overlay for why upstream BOOT_ECDSA_PSA needs
# them on this ESP32 + Zephyr 4.4 (tf-psa-crypto) stack.
#
# The private key lives in the gitignored keys/ (like devices/); BACK IT UP —
# once this MCUboot is flashed, its embedded public key is fixed, so losing the
# key means the board can only be updated via USB reflash. Not Secure Boot: this
# authenticates the OTA delivery path, not against physical/flash tampering.
SB_CONFIG_BOOT_SIGNATURE_TYPE_ECDSA_P256=y
# ${WEST_TOPDIR} is expanded by string(CONFIGURE) in both the app and mcuboot
# key-file resolution, yielding an absolute path both images accept (a plain
# relative path resolves differently per image). Keeps this file machine-portable.
SB_CONFIG_BOOT_SIGNATURE_KEY_FILE="${WEST_TOPDIR}/keys/ota-signing-ecdsa-p256.pem"
```

## prj.conf
```kconfig
# SPDX-License-Identifier: Apache-2.0

CONFIG_CHIP=y
# Operational transport (WiFi vs Thread) is selected by the LEDCTRL_TRANSPORT
# choice in app/Kconfig, which sets CHIP_WIFI / CHIP_ENABLE_WIFI_STATION / WIFI
# / NET_L2_OPENTHREAD and the OpenThread FTD options per board (Thread is the
# C6 default; classic ESP32 is WiFi). Keep prj.conf transport-neutral.
CONFIG_CHIP_PROJECT_CONFIG="include/CHIPProjectConfig.h"
CONFIG_CHIP_DEVICE_VENDOR_NAME="mmmspatz"
CONFIG_CHIP_DEVICE_PRODUCT_ID=32773
CONFIG_CHIP_DEVICE_PRODUCT_NAME="LED Strip Controller"
CONFIG_STD_CPP17=y

# Matter OTA over the operational network. Requires MCUboot (see sysbuild.conf): the CHIP Zephyr
# image processor streams to slot1 and applies via boot_request_upgrade.
CONFIG_CHIP_OTA_REQUESTOR=y
# Overwrite-only MCUboot has no test/confirm cycle, so mark applied images
# permanent (the UPGRADE_TEST default's revert path never fires here).
CONFIG_CHIP_OTA_REQUEST_UPGRADE_PERMANENT=y
# The integer the requestor compares against a provider's .ota header; bump
# per released image. String is cosmetic (BasicInformation.SoftwareVersionString).
CONFIG_CHIP_DEVICE_SOFTWARE_VERSION=5
CONFIG_CHIP_DEVICE_SOFTWARE_VERSION_STRING="0.0.5"
# The image processor's apply/download path (not auto-enabled on the generic
# Zephyr platform): MCUBOOT_IMG_MANAGER provides boot_request_upgrade/
# boot_write_img_confirmed/mcuboot_swap_type; IMG_MANAGER needs STREAM_FLASH,
# which provides stream_flash_init/buffered_write for the slot1 writer.
CONFIG_STREAM_FLASH=y
CONFIG_IMG_MANAGER=y
CONFIG_MCUBOOT_IMG_MANAGER=y

CONFIG_NETWORKING=y
CONFIG_NET_IPV6=y
# chip-module defaults 14 multicast address slots; 5 covers the WiFi device's
# groups (all-nodes, mDNS, solicited-node) at a few bytes each. Thread joins
# more (ff02/ff03 all-nodes+all-routers, solicited-node, SRP): bump in the C6
# board conf if Thread multicast joins fail (RAM allows on the C6; classic
# dram0 does not, so it stays here).
CONFIG_NET_IF_MCAST_IPV6_ADDR_COUNT=5

# BLE for commissioning (CHIPoBLE)
CONFIG_BT=y
CONFIG_BT_PERIPHERAL=y
CONFIG_BT_DEVICE_NAME="LEDStrip"
# CHIPoBLE GATT callbacks run on the (default) dedicated BT RX workqueue;
# Zephyr's 1200-byte default overflows there.
CONFIG_BT_RX_STACK_SIZE=4096
# CHIPoBLE registers/unregisters its GATT service at runtime
CONFIG_BT_GATT_DYNAMIC_DB=y

# Matter storage (fabrics, WiFi creds, chip-fct provisioning keys)
CONFIG_SETTINGS=y
CONFIG_NVS=y

# Crypto: CHIP's PSA backend against Zephyr 4.4's mbedTLS 4.x +
# TF-PSA-Crypto split (the legacy MBEDTLS_*_C Kconfig surface is gone).
# ECDSA/ECDH/P-256/CCM/HKDF/SHA-256 PSA_WANTs arrive via CHIP_CRYPTO_PSA
# implies; SPAKE2+ stays on the mbedTLS backend (chip_crypto_spake2p
# choice default) because TF-PSA-Crypto has no PSA_WANT_ALG_SPAKE2P_MATTER.
CONFIG_CHIP_CRYPTO_PSA=y
CONFIG_MBEDTLS=y
CONFIG_MBEDTLS_ENABLE_HEAP=y
CONFIG_MBEDTLS_HEAP_SIZE=8192
CONFIG_MBEDTLS_PSA_CRYPTO_C=y
CONFIG_PSA_WANT_KEY_TYPE_ECC_KEY_PAIR_IMPORT=y
CONFIG_PSA_WANT_KEY_TYPE_ECC_KEY_PAIR_EXPORT=y
CONFIG_PSA_WANT_KEY_TYPE_HMAC=y
# SPAKE2+ fallback needs mbedTLS private struct access (CHIP #71479)
CONFIG_MBEDTLS_DECLARE_PRIVATE_IDENTIFIERS=y
# ...and the legacy MD dispatch layer (mbedtls_md_info_from_type in
# CHIPCryptoPALPSA's Spake2p InitInternal); still a real option in 4.4's
# Kconfig.tf-psa-crypto despite the MBEDTLS_*_C purge elsewhere.
CONFIG_MBEDTLS_MD_C=y
# Fast reduction for the NIST P-256 prime field. Default-off here, which left
# CASE Sigma2 (~3 P-256 scalar-mults) at ~2.1 s of pure-software big-integer
# reduction on this ESP32 (no ECC HW accelerator; SOC_ECDSA/ECC_SUPPORTED unset,
# and the MPI accelerator can't hook tf-psa-crypto's bignum) — the bottleneck
# behind Matter session-establishment saturation (see the case-saturation memo).
# Flash-only cost (~1-2K .text in tf-psa-crypto ecp_curves.c), no dram0 hit.
CONFIG_MBEDTLS_ECP_NIST_OPTIM=y
# PSA ITS backend for operational keys (settings-backed)
CONFIG_SECURE_STORAGE=y

# No CONFIG_THREAD_LOCAL_STORAGE: xtensa has no ARCH_HAS_THREAD_LOCAL_STORAGE,
# so the old =y never took effect (verified in the 4.3 build's .config);
# Zephyr 4.4's Kconfig makes such no-op assignments fatal. CHIP's own
# CHIP_SYSTEM_THREAD_LOCAL_STORAGE handles what it needs.

CONFIG_CHIP_ENABLE_PAIRING_AUTOSTART=y
CONFIG_CHIP_BLE_EXT_ADVERTISING=y
CONFIG_CHIP_BLE_ADVERTISING_DURATION=60

# getopt collision between newlib-nano and Zephyr shell (hispidin postmortem)
CONFIG_CHIP_LIB_SHELL=n

CONFIG_LOG=y
# Synchronous logging: no ring buffer, no processing thread. Trades per-call
# latency for RAM. Both boards want the RAM: dram0 is full, and the C6's
# unified SRAM is dominated by the CHIP heap + radio pools.
CONFIG_LOG_MODE_MINIMAL=y

CONFIG_SYSTEM_WORKQUEUE_STACK_SIZE=4096
CONFIG_MAIN_STACK_SIZE=4096

# --- Allocator policy (portable; heap SIZE is per-board) ---
# All runtime allocation goes through CHIP's sys_heap allocator, which
# overrides malloc/free globally via --wrap (on the classic ESP32 its
# buffer is additionally relocated to the second DRAM bank via
# patches/connectedhomeip/0002). One allocator on every board: the common
# libc malloc arena would otherwise initialize with whatever is left over
# (~0 bytes on the ESP32, panicking at boot).
CONFIG_CHIP_MALLOC_SYS_HEAP=y
CONFIG_COMMON_LIBC_MALLOC=n
# patches/connectedhomeip/0002 rebuilds the CHIP allocator on
# sys_multi_heap on every board (the second bank just stays empty where
# nothing reclaims RAM), so the kernel's multi-heap code must always link.
# On the classic ESP32 the BT-reclaim Kconfig also selects this; here it
# covers everyone else.
CONFIG_MULTI_HEAP=y
# Off by default; images opt in where the RAM allows (see the board confs).
CONFIG_SHELL=n
# Matter needs more UDP contexts than Zephyr's default of 6 (mDNS,
# operational sessions, DHCP client).
CONFIG_NET_MAX_CONTEXTS=8
# net_bufs: chip-module defaults 80/80 (~25K); Matter-over-WiFi runs on far
# fewer. net_pkts: chip-module 16/16. Revisit if pkt drops appear under load.
CONFIG_NET_BUF_RX_COUNT=36
CONFIG_NET_BUF_TX_COUNT=36
CONFIG_NET_PKT_RX_COUNT=10
CONFIG_NET_PKT_TX_COUNT=10

# LED drive. Color math is float-only (-Werror=double-promotion); FPU
# availability is per-SoC (Xtensa LX6 has one, the C6's rv32imac core
# soft-floats), so CONFIG_FPU lives in boards/*.conf.
CONFIG_PWM=y
CONFIG_GPIO=y
```

## prov.conf
```kconfig
# SPDX-License-Identifier: Apache-2.0
#
# Provisioning build variant -- CLASSIC ESP32 ONLY:
#   west build -b btf_wled_esp32/esp32/procpu app -- -DEXTRA_CONF_FILE=prov.conf
#
# Adds a UART shell with the matter_prov commands. On the classic ESP32 the
# shell does not fit the production image's RAM budget, so provisioning is a
# separate image: flash this, run scripts/provision.py, flash the production
# image. The chip-fct settings written here live in the storage partition,
# which reflashing does not touch.
#
# The C6 does NOT use this file: its 512K SRAM carries the shell in the
# production image itself (CONFIG_SHELL/LEDCTRL_PROV_SHELL in
# app/boards/btf_wled_esp32c6_esp32c6_hpcore.conf), so there is no separate
# prov image and no reflash step -- provision the shipping image in place.

CONFIG_SHELL=y
CONFIG_LEDCTRL_PROV_SHELL=y

# No commissioning happens on the provisioning image; dropping BT frees
# the 56K controller DRAM reserve, which pays for the shell many times
# over.
CONFIG_BT=n

# Slim the shell: no history/completion/colors, small stacks/buffers.
CONFIG_SHELL_STACK_SIZE=2560
CONFIG_SHELL_HISTORY=n
CONFIG_SHELL_TAB=n
CONFIG_SHELL_WILDCARD=n
CONFIG_SHELL_VT100_COLORS=n
CONFIG_SHELL_CMDS=n
CONFIG_DEVICE_SHELL=n
CONFIG_DEVMEM_SHELL=n
# base64 verifier makes the set command ~230 chars
CONFIG_SHELL_CMD_BUFF_SIZE=320
CONFIG_SHELL_BACKEND_SERIAL_RX_RING_BUFFER_SIZE=512

# Make room: shell thread stack lives in the second DRAM bank alongside
# the CHIP heap; shrink the heap slightly for this bench-only image.
CONFIG_CHIP_MALLOC_SYS_HEAP_SIZE=36864
```

## rgb.conf
```kconfig
# SPDX-License-Identifier: Apache-2.0
#
# Extra config fragment for the 3-channel RGB strip variant:
#   west build -b btf_wled_esp32/esp32/procpu app -- -DEXTRA_CONF_FILE=rgb.conf
# Selects the rgb_light.zap data model (Extended Color Light, 0x010D).

CONFIG_LEDCTRL_MODE_RGB=y
```

## thread-diag.conf
```kconfig
# Thread diagnostic overlay (C6): OpenThread CLI + ping sender for on-air
# fragmentation testing. Not a production image. Use with:
#   west build -d build_diag -b btf_wled_esp32c6/esp32c6/hpcore app \
#       -- -DEXTRA_CONF_FILE=thread-diag.conf
#
# NB: OT INFO logging (OPENTHREAD_DEBUG / LOG_LEVEL_INFO) does NOT link under
# LOG_MODE_MINIMAL (undefined z_log_msg_runtime_vcreate) -- left off here.
CONFIG_OPENTHREAD_SHELL=y
CONFIG_OPENTHREAD_PING_SENDER=y
CONFIG_OPENTHREAD_DIAG=y

# Surface the 15.4 driver's TX error path (the new -EBUSY/-ENOMSG/-EIO
# returns) so retransmission activity is visible during the sweep.
CONFIG_IEEE802154_DRIVER_LOG_LEVEL_ERR=y
```

## wifi-diag.conf
```kconfig
# WiFi diagnostic overlay (C6 WiFi build): instrumentation for the open
# "drops fully off WiFi after 1.7-6 h" bug. Not a production image. Use with:
#
#   west build --sysbuild -d build_wifidiag -p always \
#       -b btf_wled_esp32c6/esp32c6/hpcore app \
#       -- -DEXTRA_CONF_FILE="wifi.conf;wifi-diag.conf" \
#          -DEXTRA_DTC_OVERLAY_FILE=wifi.overlay \
#          -DCONFIG_LEDCTRL_WIFI_CREDS_SHELL=y
#
# Attack the fast symptom first. This board already re-establishes WiFi about
# every 100 s (see the kDnssdInitialized comment in
# scaffold/CommonDeviceCallbacks.cpp) -- that reproduces in two minutes, and
# it is what eventually feeds a run of failed scans into the recovery backoff.
# The multi-hour death is the downstream consequence, not the thing to sit and
# wait for.

# Full logging backend. prj.conf uses LOG_MODE_MINIMAL, which cannot render the
# runtime-formatted messages these modules emit -- the same constraint that
# keeps OpenThread INFO logs out of thread-diag.conf. IMMEDIATE rather than
# DEFERRED so nothing is stranded in a buffer when the link dies.
#
# Caveat: IMMEDIATE blocks the logging thread on a 115200 UART. If the extra
# latency perturbs the failure, drop CONFIG_WIFI_LOG_LEVEL_DBG to _INF first --
# the disconnect reason codes below are logged at INF.
CONFIG_LOG_MODE_IMMEDIATE=y

# esp32_wifi driver (LOG_MODULE_REGISTER(esp32_wifi, CONFIG_WIFI_LOG_LEVEL)) and
# the L2 management layer. The single most informative datum is the 802.11
# disconnect reason WiFiManager records via SetLastDisconnectReason(): reason 4
# (inactivity) vs 15 (4-way handshake / rekey timeout) vs 2 immediately splits
# AP-side eviction from device-side failure.
#
# NET_LOG is load-bearing, not decoration: every net subsys log level goes
# through Kconfig.template.log_config.net, whose choice is `depends on
# NET_LOG` and whose level falls back to `0 if !$(module-dep)`. Without it the
# NET_L2_WIFI_MGMT assignment below is silently ignored and the level stays
# OFF. (The esp32_wifi driver uses the plain template and does not need it.)
CONFIG_NET_LOG=y
CONFIG_WIFI_LOG_LEVEL_DBG=y
CONFIG_NET_L2_WIFI_MGMT_LOG_LEVEL_DBG=y

# `wifi status` (state, RSSI, channel, BSSID), `wifi ps` and `wifi statistics`;
# `net iface` / `net stats` / `net conn` for the IP side. Poll these from the
# host over the console -- no firmware change needed to graph RSSI or to
# capture the state at the moment of death. `wifi ps off` also makes power
# save a runtime experiment: nothing in prj.conf pins it, so the build runs on
# the Espressif default (min-modem PS), a decent prior for periodic deauth.
CONFIG_NET_SHELL=y
CONFIG_NET_L2_WIFI_SHELL=y

# Runtime log filtering, and it is not optional in practice. CHIP registers its
# Zephyr log module as LOG_MODULE_REGISTER(chip, LOG_LEVEL_DBG) -- hardcoded, so
# MATTER_LOG_LEVEL cannot dial it down and every [DMG]/[EM] line is emitted. At
# 115200 that alone outruns the UART: measured, the log stream fell ~90 s behind
# real time within a two-minute capture, and under LOG_MODE_IMMEDIATE the device
# blocks on those writes, distorting the very timing being investigated.
#
# So after boot, silence CHIP and keep the radio at debug:
#
#   log enable wrn chip
#   log enable dbg esp32_wifi
#   log status
#
# Raise `chip` back to inf when you want WiFiManager's own progress lines (the
# recovery re-scan interval and the disconnect reason are ChipLogProgress).
CONFIG_LOG_RUNTIME_FILTERING=y
CONFIG_LOG_CMDS=y

# Collapse the recovery backoff so the recovery path itself is testable in
# minutes. Stock MAXIMUM_INTERVAL is 3600000 ms and the interval doubles from
# MINIMUM_INTERVAL (500 ms) on each failed re-scan, so reaching the top of the
# ramp takes 13 doublings ~= 68 min of wall time. At 60000 ms it is 7 doublings
# ~= 2 min. Pair with patches/connectedhomeip/0007 (the jitter at the top of
# that ramp was uninitialised, which is what made the failure terminal).
#
# Diagnostic only -- do NOT copy into prj.conf without deciding what recovery
# cadence the product actually wants.
CONFIG_CHIP_WIFI_CONNECTION_RECOVERY_MAXIMUM_INTERVAL=60000
```

## wifi.conf
```kconfig
# SPDX-License-Identifier: Apache-2.0
#
# C6 WiFi build variant. The C6's default operational transport is
# Matter-over-Thread (see the LEDCTRL_TRANSPORT choice in app/Kconfig); this
# fragment forces WiFi instead. Pair it with the matching DT overlay:
#
#   west build --sysbuild -b btf_wled_esp32c6/esp32c6/hpcore app \
#       -- -DEXTRA_CONF_FILE=wifi.conf -DEXTRA_DTC_OVERLAY_FILE=wifi.overlay
#
# Composes with rgb.conf, e.g. C6 RGB over WiFi:
#   -DEXTRA_CONF_FILE="rgb.conf;wifi.conf" -DEXTRA_DTC_OVERLAY_FILE=wifi.overlay
#
# No-op on the classic ESP32, which is WiFi by default (and has no 802.15.4
# radio for Thread anyway).

CONFIG_LEDCTRL_TRANSPORT_WIFI=y
```

## wifi.overlay
```dts
/*
 * SPDX-License-Identifier: Apache-2.0
 *
 * Devicetree overlay for the C6 WiFi build variant (pairs with wifi.conf).
 * The board DTS defaults to Thread (ieee802154 = okay, wifi = disabled); flip
 * them back for a WiFi build. Disabling the ieee802154 node clears
 * DT_HAS_ESPRESSIF_ESP32_IEEE802154_ENABLED so the 802.15.4 driver is not
 * built. The board's `zephyr,ieee802154` chosen entry is left pointing at the
 * now-disabled node -- harmless, since the OpenThread platform radio that
 * consumes it is not compiled when NET_L2_OPENTHREAD is off.
 */

&wifi {
	status = "okay";
};

&ieee802154 {
	status = "disabled";
};
```

## src/main.c
```c
/*
 * SPDX-License-Identifier: Apache-2.0
 *
 * M0 board bring-up: cycle each LED channel through a CIE-curve fade and
 * log S1 button events. Replaced by the Matter application at milestone M2;
 * led_pwm.c and color_math.c carry forward unchanged.
 */

#include <zephyr/input/input.h>
#include <zephyr/kernel.h>
#include <zephyr/logging/log.h>

#include "color_math.h"
#include "led_pwm.h"

LOG_MODULE_REGISTER(main, CONFIG_LOG_DEFAULT_LEVEL);

static volatile bool paused;

static void button_cb(struct input_event *evt, void *user_data)
{
	ARG_UNUSED(user_data);

	if (evt->type == INPUT_EV_KEY && evt->code == INPUT_KEY_0) {
		LOG_INF("S1 button %s", evt->value ? "pressed" : "released");
		if (evt->value) {
			paused = !paused;
			LOG_INF("fade %s", paused ? "paused" : "resumed");
		}
	}
}
INPUT_CALLBACK_DEFINE(NULL, button_cb, NULL);

int main(void)
{
	LOG_INF("BTF WLED ESP32 bring-up (M0)");

	if (led_pwm_init() != 0) {
		LOG_ERR("led_pwm_init failed");
		return -1;
	}

	uint8_t ch = 0;

	while (true) {
		LOG_INF("fading CH%d", ch + 1);

		for (int level = 0; level <= 508; level += 2) {
			/* 0..254 up then back down */
			uint8_t l = level <= 254 ? (uint8_t)level
						 : (uint8_t)(508 - level);

			led_pwm_set(ch, cm_cie1931_brightness(l));
			k_sleep(K_MSEC(8));

			while (paused) {
				k_sleep(K_MSEC(50));
			}
		}

		led_pwm_set(ch, 0.0f);
		ch = (ch + 1) % LED_PWM_NUM_CH;
	}

	return 0;
}
```

## include/AppEvent.h
```c
/* SPDX-License-Identifier: Apache-2.0 */

#pragma once

#include <cstdint>

struct AppEvent;
using EventHandler = void (*)(const AppEvent &);

struct AppEvent {
	enum AppEventTypes {
		kEventType_Timer = 0,
	};

	uint16_t Type;

	union {
		struct {
			void *Context;
		} TimerEvent;
	};

	EventHandler Handler;
};
```

## include/AppTask.h
```c
/* SPDX-License-Identifier: Apache-2.0 */

#pragma once

#include "AppTaskZephyr.h"

class AppTask: public chip::Zephyr::App::AppTaskZephyr
{
      public:
	~AppTask() override {};
	void PreInitMatterStack(void) override;
	void PostInitMatterServerInstance(void) override;

	static AppTask &GetDefaultInstance();

      private:
	static AppTask sAppTask;
};
```

## include/CHIPProjectConfig.h
```c
/*
 * SPDX-License-Identifier: Apache-2.0
 *
 * Project-specific overrides of CHIP's default configuration.
 */

#pragma once

// Bench-fallback pairing code, used only when nothing has been provisioned
// into the chip-fct settings namespace (see scripts/provision.py).
#ifndef CHIP_DEVICE_CONFIG_USE_TEST_SETUP_PIN_CODE
#define CHIP_DEVICE_CONFIG_USE_TEST_SETUP_PIN_CODE 20202021
#endif

#ifndef CHIP_DEVICE_CONFIG_USE_TEST_SETUP_DISCRIMINATOR
#define CHIP_DEVICE_CONFIG_USE_TEST_SETUP_DISCRIMINATOR 0xF00
#endif

#ifdef __ZEPHYR__
#define CHIP_DEVICE_CONFIG_CHIP_TASK_NAME     "Matter"
#define CHIP_DEVICE_CONFIG_CHIP_TASK_PRIORITY (K_PRIO_PREEMPT(10))
#endif

#define CHIP_CONFIG_SECURITY_TEST_MODE 0

// Test vendor ID; required while the device presents the example DAC.
#define CHIP_DEVICE_CONFIG_DEVICE_VENDOR_ID  0xFFF1
#define CHIP_DEVICE_CONFIG_DEVICE_PRODUCT_ID 0x8005

// Follows CONFIG_BT so the BT-less provisioning image builds (prov.conf).
#ifdef CONFIG_BT
#define CHIP_DEVICE_CONFIG_ENABLE_CHIPOBLE 1
#else
#define CHIP_DEVICE_CONFIG_ENABLE_CHIPOBLE 0
#endif

#define CHIP_DEVICE_CONFIG_TEST_SERIAL_NUMBER "TEST_SN"

#define CHIP_DEVICE_CONFIG_EVENT_LOGGING_UTC_TIMESTAMPS   1
// DEBUG/INFO event buffers already default to 512; CRIT defaults to 1024.
#define CHIP_DEVICE_CONFIG_EVENT_LOGGING_CRIT_BUFFER_SIZE (512)

#define CHIP_CONFIG_MRP_LOCAL_ACTIVE_RETRY_INTERVAL (2000_ms32)

// Zephyr 4.3 provides recvmsg natively; CHIP's static shim would collide
// with the extern declaration.
#define CHIP_SYSTEM_CONFIG_USE_ZEPHYR_SOCKET_EXTENSIONS 0

// ---- RAM budget (ESP32 dram0_0_seg is 136K after the BT reserve) ----

// Allocate System::PacketBuffers from the heap instead of a static 24K
// pool; actual concurrent usage is far below the pool's worst case.
#define CHIP_SYSTEM_CONFIG_PACKETBUFFER_POOL_SIZE 0

// Home Assistant + Alexa + a commissioning tool + one spare. The IM and
// session pools all derive their (spec-8.5.1-compliant) sizes from this.
#define CHIP_CONFIG_MAX_FABRICS 4

// Group (multicast) messaging peer counters; a standalone light sees at
// most a couple of group senders per fabric, not the default 15.
#define CHIP_CONFIG_MAX_GROUP_DATA_PEERS 4

#define CHIP_DEVICE_CONFIG_MAX_EVENT_QUEUE_SIZE 16
```

## include/DeviceCallbacks.h
```c
/* SPDX-License-Identifier: Apache-2.0 */

#pragma once

#include "CHIPDeviceManager.h"
#include "CommonDeviceCallbacks.h"

namespace LedCtrl
{

class DeviceCallbacks: public chip::Zephyr::App::CommonDeviceCallbacks
{
      public:
	void PostAttributeChangeCallback(chip::EndpointId endpoint, chip::ClusterId clusterId,
					 chip::AttributeId attributeId, uint8_t type, uint16_t size,
					 uint8_t *value) override;
};

} // namespace LedCtrl

namespace chip::Zephyr::App
{

/* Scaffold hook: AppTaskBase::Init registers this with CHIPDeviceManager. */
chip::DeviceManager::CHIPDeviceManagerCallbacks &GetDeviceCallbacks();

} // namespace chip::Zephyr::App
```

## include/LightingManager.h
```c
/*
 * SPDX-License-Identifier: Apache-2.0
 *
 * Owns the mapping from Matter cluster state (OnOff / LevelControl /
 * ColorControl) to PWM channel duties. Called from the Matter thread
 * (attribute-change callbacks); the actual PWM writes happen on the
 * system workqueue through a short fade smoother.
 */

#pragma once

#include <cstdint>

class LightingManager
{
      public:
	static LightingManager &Instance();

	/* Drives all channels off; call before the Matter stack starts. */
	void Init();

	void SetOnOff(bool on);
	void SetLevel(uint8_t level);             /* LevelControl CurrentLevel, 1..254 */
	void SetColorTempMireds(uint16_t mireds); /* ColorControl ColorTemperatureMireds */

#ifdef CONFIG_LEDCTRL_MODE_RGB
	/* ColorControl ColorMode / EnhancedColorMode values */
	enum ColorMode : uint8_t {
		kHueSaturation = 0,
		kXy = 1,
		kColorTemp = 2,
	};

	void SetColorMode(uint8_t mode);
	void SetHue(uint8_t hue);
	void SetSaturation(uint8_t sat);
	void SetXy(uint16_t x, uint16_t y);
#endif

      private:
	void Apply();

	bool mOn = false;
	uint8_t mLevel = 254;
	uint16_t mMireds = 250; /* ~4000K neutral default */

#ifdef CONFIG_LEDCTRL_MODE_RGB
	uint8_t mColorMode = kColorTemp;
	uint8_t mHue = 0;
	uint8_t mSat = 0;
	uint16_t mX = 20500; /* ~D65 white */
	uint16_t mY = 21500;
#endif
};
```

## src/AppTask.cpp
```c
/* SPDX-License-Identifier: Apache-2.0 */

#include "AppTask.h"

#include <app-common/zap-generated/attributes/Accessors.h>
#include <app/server/Server.h>
#include <platform/CHIPDeviceLayer.h>

#include <zephyr/drivers/gpio.h>
#include <zephyr/kernel.h>
#include <zephyr/logging/log.h>

#include "LightingManager.h"

LOG_MODULE_DECLARE(app, CONFIG_CHIP_APP_LOG_LEVEL);

using namespace chip;
using namespace chip::DeviceLayer;

AppTask AppTask::sAppTask;

/* -------------------------------------------------------------------------- */
/*                        Button S1 (GPIO0, active-low)                       */
/* -------------------------------------------------------------------------- */

#if DT_NODE_EXISTS(DT_ALIAS(sw0))
#define HAS_BUTTON0 1
static const struct gpio_dt_spec sButton0 = GPIO_DT_SPEC_GET(DT_ALIAS(sw0), gpios);
static struct gpio_callback sButton0CbData;
static struct k_work_delayable sFactoryResetWarningWork;
static struct k_work_delayable sFactoryResetTriggerWork;

static void FactoryResetWarningWorkHandler(struct k_work *work)
{
	LOG_INF("Keep holding to factory reset in 3 seconds. Release to cancel.");
}

static void FactoryResetTriggerWorkHandler(struct k_work *work)
{
	LOG_INF("Factory reset triggered");
	chip::Server::GetInstance().ScheduleFactoryReset();
}

static void Button0Handler(const struct device *dev, struct gpio_callback *cb, uint32_t pins)
{
	if (gpio_pin_get_dt(&sButton0) > 0) {
		k_work_schedule(&sFactoryResetWarningWork, K_SECONDS(2));
		k_work_schedule(&sFactoryResetTriggerWork, K_SECONDS(5));
	} else {
		if (k_work_cancel_delayable(&sFactoryResetTriggerWork) != 0) {
			LOG_INF("Factory reset canceled");
		}
		k_work_cancel_delayable(&sFactoryResetWarningWork);
	}
}

static void ButtonInit()
{
	if (!gpio_is_ready_dt(&sButton0)) {
		LOG_ERR("Button device not ready");
		return;
	}
	gpio_pin_configure_dt(&sButton0, GPIO_INPUT);
	gpio_pin_interrupt_configure_dt(&sButton0, GPIO_INT_EDGE_BOTH);
	gpio_init_callback(&sButton0CbData, Button0Handler, BIT(sButton0.pin));
	gpio_add_callback(sButton0.port, &sButton0CbData);
	k_work_init_delayable(&sFactoryResetWarningWork, FactoryResetWarningWorkHandler);
	k_work_init_delayable(&sFactoryResetTriggerWork, FactoryResetTriggerWorkHandler);
}
#endif /* DT_NODE_EXISTS(DT_ALIAS(sw0)) */

/* -------------------------------------------------------------------------- */
/*                              AppTask hooks                                 */
/* -------------------------------------------------------------------------- */

void AppTask::PreInitMatterStack()
{
	/* MOSFET gates float at reset; drive every channel off before anything
	 * else runs.
	 */
	LightingManager::Instance().Init();

#ifdef HAS_BUTTON0
	ButtonInit();
#endif
}

void AppTask::PostInitMatterServerInstance()
{
	/* OnOff/Level/ColorTemp persist across reboot and are restored by the
	 * cluster servers WITHOUT firing attribute-change callbacks (and a
	 * command that doesn't change an attribute never fires one either).
	 * Prime LightingManager from live cluster state so its cache can't
	 * start out disagreeing with the data model.
	 */
	using namespace chip::app::Clusters;
	constexpr chip::EndpointId kLight = 1;

	auto &lighting = LightingManager::Instance();

	chip::app::DataModel::Nullable<uint8_t> level;
	if (LevelControl::Attributes::CurrentLevel::Get(kLight, level) ==
		    chip::Protocols::InteractionModel::Status::Success &&
	    !level.IsNull()) {
		lighting.SetLevel(level.Value());
	}

	uint16_t mireds;
	if (ColorControl::Attributes::ColorTemperatureMireds::Get(kLight, &mireds) ==
	    chip::Protocols::InteractionModel::Status::Success) {
		lighting.SetColorTempMireds(mireds);
	}

	bool isOn = false;
	if (OnOff::Attributes::OnOff::Get(kLight, &isOn) ==
	    chip::Protocols::InteractionModel::Status::Success) {
		lighting.SetOnOff(isOn);
	}

	LOG_INF("LED controller ready (on=%d)", isOn);
}

AppTask &AppTask::GetDefaultInstance()
{
	return sAppTask;
}

/* Declared in AppTaskBase.h; the scaffold's main() enters through this. */
chip::Zephyr::App::AppTaskBase &chip::Zephyr::App::GetAppTask()
{
	return AppTask::GetDefaultInstance();
}
```

## src/DeviceCallbacks.cpp
```c
/* SPDX-License-Identifier: Apache-2.0 */

#include "DeviceCallbacks.h"

#include <app-common/zap-generated/attributes/Accessors.h>
#include <app-common/zap-generated/ids/Attributes.h>
#include <app-common/zap-generated/ids/Clusters.h>
#include <lib/support/logging/CHIPLogging.h>

#include "LightingManager.h"

using namespace ::chip;
using namespace ::chip::app::Clusters;

namespace
{
constexpr EndpointId kLightEndpointId = 1;
} // namespace

void LedCtrl::DeviceCallbacks::PostAttributeChangeCallback(EndpointId endpoint, ClusterId clusterId,
							   AttributeId attributeId, uint8_t type,
							   uint16_t size, uint8_t *value)
{
	VerifyOrReturn(endpoint == kLightEndpointId && value != nullptr);

	auto &lighting = LightingManager::Instance();

	switch (clusterId) {
	case OnOff::Id:
		if (attributeId == OnOff::Attributes::OnOff::Id) {
			lighting.SetOnOff(*value != 0);
		}
		break;
	case LevelControl::Id:
		if (attributeId == LevelControl::Attributes::CurrentLevel::Id) {
			lighting.SetLevel(*value);
		}
		break;
	case ColorControl::Id:
		if (attributeId == ColorControl::Attributes::ColorTemperatureMireds::Id &&
		    size == sizeof(uint16_t)) {
			uint16_t mireds;
			memcpy(&mireds, value, sizeof(mireds));
			lighting.SetColorTempMireds(mireds);
		}
#ifdef CONFIG_LEDCTRL_MODE_RGB
		else if (attributeId == ColorControl::Attributes::CurrentHue::Id) {
			lighting.SetHue(*value);
		} else if (attributeId == ColorControl::Attributes::CurrentSaturation::Id) {
			lighting.SetSaturation(*value);
		} else if ((attributeId == ColorControl::Attributes::CurrentX::Id ||
			    attributeId == ColorControl::Attributes::CurrentY::Id) &&
			   size == sizeof(uint16_t)) {
			/* X and Y arrive as separate writes; read the sibling from the
			 * cluster so each update is applied as a consistent pair.
			 */
			uint16_t x, y;
			if (ColorControl::Attributes::CurrentX::Get(endpoint, &x) ==
				    chip::Protocols::InteractionModel::Status::Success &&
			    ColorControl::Attributes::CurrentY::Get(endpoint, &y) ==
				    chip::Protocols::InteractionModel::Status::Success) {
				lighting.SetXy(x, y);
			}
		} else if (attributeId == ColorControl::Attributes::ColorMode::Id) {
			lighting.SetColorMode(*value);
		}
#endif
		break;
	default:
		break;
	}
}

chip::DeviceManager::CHIPDeviceManagerCallbacks &chip::Zephyr::App::GetDeviceCallbacks()
{
	static LedCtrl::DeviceCallbacks sDeviceCallbacks;
	return sDeviceCallbacks;
}
```

## src/HeapStatsShell.cpp
```c
/*
 * SPDX-License-Identifier: Apache-2.0
 *
 * `chip_heap` shell command: prints the CHIP sys_heap free/used/high-water,
 * for right-sizing CONFIG_CHIP_MALLOC_SYS_HEAP_SIZE against measured peak
 * usage on hardware (commissioning and OTA are the stress cases). Present
 * whenever the shell is (the C6 production image; the classic prov.conf).
 * Malloc::GetStats is lock-guarded, so this is safe to call from the shell
 * thread while CHIP runs.
 */

#include <zephyr/shell/shell.h>

#include <lib/core/CHIPError.h>
#include <platform/Zephyr/SysHeapMalloc.h>

using chip::DeviceLayer::Malloc::GetStats;

static int cmd_chip_heap(const struct shell * sh, size_t argc, char ** argv)
{
#ifdef CONFIG_SYS_HEAP_RUNTIME_STATS
	chip::DeviceLayer::Malloc::Stats stats;
	if (GetStats(stats) != CHIP_NO_ERROR)
	{
		shell_error(sh, "chip_heap: GetStats failed");
		return -1;
	}
	shell_print(sh, "chip_heap size=%u free=%u used=%u high_water=%u",
		    (unsigned) CONFIG_CHIP_MALLOC_SYS_HEAP_SIZE, (unsigned) stats.free, (unsigned) stats.used,
		    (unsigned) stats.maxUsed);
#else
	shell_print(sh, "chip_heap: CONFIG_SYS_HEAP_RUNTIME_STATS not enabled");
#endif
	return 0;
}

SHELL_CMD_REGISTER(chip_heap, NULL, "CHIP sys_heap free/used/high-water (bytes)", cmd_chip_heap);
```

## src/LightingManager.cpp
```c
/* SPDX-License-Identifier: Apache-2.0 */

#include "LightingManager.h"

#include <math.h>

#include <zephyr/kernel.h>
#include <zephyr/logging/log.h>

#include "color_math.h"
#include "led_pwm.h"

LOG_MODULE_REGISTER(lighting, CONFIG_CHIP_APP_LOG_LEVEL);

/*
 * The ColorControl/LevelControl cluster servers tick transitions every
 * 100ms (TRANSITION_UPDATE_TIME_MS), which reads as visible stepping if
 * each attribute write lands on the PWM directly. Smooth over it: every
 * tick of a 20ms work item, each channel moves a fixed fraction of its
 * remaining distance to target (~80ms time constant), turning the 10Hz
 * staircase into a glide and giving on/off a soft edge for free.
 */
namespace
{
constexpr int kFadeIntervalMs = 20;
constexpr float kFadeAlpha = 0.22f;
constexpr float kSettled = 0.0005f;

float sCurrent[LED_PWM_NUM_CH];
float sTarget[LED_PWM_NUM_CH];
struct k_work_delayable sFadeWork;

void FadeWorkHandler(struct k_work *work)
{
	bool active = false;

	for (uint8_t ch = 0; ch < LED_PWM_NUM_CH; ch++) {
		float delta = sTarget[ch] - sCurrent[ch];
		if (fabsf(delta) < kSettled) {
			sCurrent[ch] = sTarget[ch];
		} else {
			sCurrent[ch] += delta * kFadeAlpha;
			active = true;
		}
		led_pwm_set(ch, sCurrent[ch]);
	}

	if (active) {
		k_work_schedule(&sFadeWork, K_MSEC(kFadeIntervalMs));
	}
}

void SetChannelTargets(const float *targets)
{
	for (uint8_t ch = 0; ch < LED_PWM_NUM_CH; ch++) {
		sTarget[ch] = targets[ch];
	}
	k_work_schedule(&sFadeWork, K_NO_WAIT);
}
} // namespace

LightingManager &LightingManager::Instance()
{
	static LightingManager sInstance;
	return sInstance;
}

void LightingManager::Init()
{
	led_pwm_init();
	k_work_init_delayable(&sFadeWork, FadeWorkHandler);
}

void LightingManager::SetOnOff(bool on)
{
	mOn = on;
	Apply();
}

void LightingManager::SetLevel(uint8_t level)
{
	mLevel = level;
	Apply();
}

void LightingManager::SetColorTempMireds(uint16_t mireds)
{
	mMireds = mireds;
#ifdef CONFIG_LEDCTRL_MODE_RGB
	mColorMode = kColorTemp;
#endif
	Apply();
}

#ifdef CONFIG_LEDCTRL_MODE_RGB
void LightingManager::SetColorMode(uint8_t mode)
{
	mColorMode = mode;
	Apply();
}

void LightingManager::SetHue(uint8_t hue)
{
	mHue = hue;
	mColorMode = kHueSaturation;
	Apply();
}

void LightingManager::SetSaturation(uint8_t sat)
{
	mSat = sat;
	mColorMode = kHueSaturation;
	Apply();
}

void LightingManager::SetXy(uint16_t x, uint16_t y)
{
	mX = x;
	mY = y;
	mColorMode = kXy;
	Apply();
}
#endif

void LightingManager::Apply()
{
	float targets[LED_PWM_NUM_CH] = {0.0f, 0.0f, 0.0f};

	if (mOn) {
		float brightness = cm_cie1931_brightness(mLevel);

#if defined(CONFIG_LEDCTRL_MODE_CCT)
		float warm, cool;
		cm_ct_mix(mMireds, CONFIG_LEDCTRL_MIREDS_COOL, CONFIG_LEDCTRL_MIREDS_WARM, &warm,
			  &cool);
		targets[CONFIG_LEDCTRL_CH_WARM] = warm * brightness;
		targets[CONFIG_LEDCTRL_CH_COOL] = cool * brightness;
#else
		cm_rgb_t rgb;
		switch (mColorMode) {
		case kHueSaturation:
			rgb = cm_hsv_to_rgb(mHue, mSat);
			break;
		case kXy:
			rgb = cm_xy_to_rgb(mX, mY);
			break;
		case kColorTemp:
		default:
			rgb = cm_ct_to_rgb(mMireds);
			break;
		}
		targets[0] = ((float)rgb.r / 255.0f) * brightness;
		targets[1] = ((float)rgb.g / 255.0f) * brightness;
		targets[2] = ((float)rgb.b / 255.0f) * brightness;
#endif
	}

	SetChannelTargets(targets);
	LOG_DBG("on=%d level=%u mireds=%u", mOn, mLevel, mMireds);
}
```
